/*
 * UNVERIFIED TEMPLATE — not compiled or run in CANoe
 * FOR SIMULATOR OR APPROVED LAB BENCH ONLY. NEVER RUN AGAINST A PRODUCTION VEHICLE.
 *
 * Generated by uds_assistant.export.to_capl from 8 test case(s).
 * Request/response bytes are copied verbatim from the test cases (templates +
 * rules-engine oracle, or the hand-written gold set). The ECU spec is SYNTHETIC.
 * Adapt the diagnostic target / CDD binding before use; review every test.
 *
 * NOTE: not generated by this template: configure in your CANoe environment:
 *   - the diagnostic target (ECU qualifier / CDD / ODX) the diagRequest objects bind to;
 *   - tester-side session keep-alive (TesterPresent) and the S3 timer behaviour;
 *   - handling of 7F xx 78 response-pending frames (the diag layer must absorb them);
 *   - bench set-up for the simulator-only steps (vehicle speed, NVM fault, DTC injection),
 *     which appear below as "not generated" notes;
 *   - the security-access seed/key algorithm (keys here are fixed bytes for the SYNTHETIC ECU);
 *   - test-module configuration (test environment, verdict handling, report generation).
 */

includes
{
}

variables
{
  const dword kP2TimeoutMs = 2000;      // generous tester-side timeout per request
  const dword kSilenceWaitMs = 300;     // wait used when no response is expected
}

/* Send raw request bytes and compare the final response with the expected bytes.
 * expectedLen == 0 means "no response expected" (suppressed positive response). */
int SendAndCheck(byte req[], dword reqLen, byte expected[], dword expectedLen, char stepName[])
{
  diagRequest * rawReq;
  diagResponse * rawResp;
  dword i;
  long waitResult;
  byte actual[4095];
  long actualLen;

  diagResize(rawReq, reqLen);
  for (i = 0; i < reqLen; i++)
    diagSetPrimitiveByte(rawReq, i, req[i]);
  diagSendRequest(rawReq);

  if (expectedLen == 0)
  {
    waitResult = testWaitForDiagResponse(rawReq, kSilenceWaitMs);
    if (waitResult == 1)
    {
      testStepFail(stepName, "Unexpected response (positive response should be suppressed)");
      return 0;
    }
    testStepPass(stepName, "No response, as expected");
    return 1;
  }

  waitResult = testWaitForDiagResponse(rawReq, kP2TimeoutMs);
  if (waitResult != 1)
  {
    testStepFail(stepName, "No response within timeout");
    return 0;
  }
  diagGetLastResponse(rawReq, rawResp);
  actualLen = diagGetPrimitiveSize(rawResp);
  if (actualLen != expectedLen)
  {
    testStepFail(stepName, "Response length %d, expected %d", actualLen, expectedLen);
    return 0;
  }
  for (i = 0; i < expectedLen; i++)
  {
    actual[i] = diagGetPrimitiveByte(rawResp, i);
    if (actual[i] != expected[i])
    {
      testStepFail(stepName, "Byte %d is 0x%02X, expected 0x%02X", i, actual[i], expected[i]);
      return 0;
    }
  }
  testStepPass(stepName, "Response matches");
  return 1;
}


/* Read DID driver_door_lock_state (0x0110) positively in session 0x1
 * category=positive template=read_did_positive requirements=REQ-010 origin=generated
 * Preconditions: ECU in default session (0x01)
 * Pass criteria: ECU replies 62 01 10 01 (positive) within P2 = 50 ms.
 */
testcase TC_req_010__tpl_read_did_positive_0110_01()
{
  testCaseTitle("req_010__tpl_read_did_positive_0110_01", "Read DID driver_door_lock_state (0x0110) positively in session 0x1");
  // step 0: Read DID 0x0110 (driver_door_lock_state) in session 0x1.
  {
    byte req0[3] = {0x22, 0x01, 0x10};
    byte exp0[4] = {0x62, 0x01, 0x10, 0x01};
    SendAndCheck(req0, 3, exp0, 4, "step 0");
  }
}

/* Seed request while security level 0x3 is already unlocked
 * category=security template=seed_request_while_unlocked requirements=REQ-010 origin=generated
 * Preconditions: ECU in programming session (0x02); Security level 0x03 unlocked
 * Pass criteria: All 6 requests must get exactly the expected bytes. Action under test: ECU replies 67 03 00 00 00 00 (positive) within P2 = 50 ms.
 */
testcase TC_req_010__tpl_seed_while_unlocked_03()
{
  testCaseTitle("req_010__tpl_seed_while_unlocked_03", "Seed request while security level 0x3 is already unlocked");
  // step 0: Switch to session 0x2.
  {
    byte req0[2] = {0x10, 0x02};
    byte exp0[6] = {0x50, 0x02, 0x00, 0x32, 0x01, 0xF4};
    SendAndCheck(req0, 2, exp0, 6, "step 0");
  }
  // step 1: Request seed for level 0x3.
  {
    byte req1[2] = {0x27, 0x03};
    byte exp1[6] = {0x67, 0x03, 0x0B, 0x7C, 0xED, 0x5E};
    SendAndCheck(req1, 2, exp1, 6, "step 1");
  }
  // step 2: Send computed key for level 0x3.
  {
    byte req2[6] = {0x27, 0x04, 0x20, 0xA9, 0x2D, 0xBA};
    byte exp2[2] = {0x67, 0x04};
    SendAndCheck(req2, 6, exp2, 2, "step 2");
  }
  // step 3: Request a seed again while the level is unlocked -> 'already unlocked' seed.
  {
    byte req3[2] = {0x27, 0x03};
    byte exp3[6] = {0x67, 0x03, 0x00, 0x00, 0x00, 0x00};
    SendAndCheck(req3, 2, exp3, 6, "step 3");
  }
  // step 4: Protected write to 0x0160 -> still accepted (level stays unlocked).
  {
    byte req4[5] = {0x2E, 0x01, 0x60, 0x00, 0x00};
    byte exp4[3] = {0x6E, 0x01, 0x60};
    SendAndCheck(req4, 5, exp4, 3, "step 4");
  }
  // step 5: Request a seed once more -> still the 'already unlocked' answer.
  {
    byte req5[2] = {0x27, 0x03};
    byte exp5[6] = {0x67, 0x03, 0x00, 0x00, 0x00, 0x00};
    SendAndCheck(req5, 2, exp5, 6, "step 5");
  }
}

/* Service 0x27 rejected in session 0x1
 * category=session template=service_not_in_session requirements=REQ-010 origin=generated
 * Preconditions: ECU in default session (0x01); No security level unlocked
 * Pass criteria: ECU replies 7F 27 7F (serviceNotSupportedInActiveSession) within P2 = 50 ms.
 */
testcase TC_req_010__tpl_service_not_in_session_27_01()
{
  testCaseTitle("req_010__tpl_service_not_in_session_27_01", "Service 0x27 rejected in session 0x1");
  // step 0: Service 0x27 not allowed in session 0x1 -> expect NRC 0x7F.
  {
    byte req0[2] = {0x27, 0x01};
    byte exp0[3] = {0x7F, 0x27, 0x7F};
    SendAndCheck(req0, 2, exp0, 3, "step 0");
  }
}

/* Replayed SecurityAccess key for level 0x1 is rejected
 * category=security template=seed_replay_rejected requirements=REQ-010 origin=generated
 * Preconditions: ECU in extended session (0x03); Security level 0x01 unlocked
 * Pass criteria: All 4 requests must get exactly the expected bytes. Action under test: ECU replies 7F 27 24 (requestSequenceError) within P2 = 50 ms.
 */
testcase TC_req_010__tpl_seed_replay_01()
{
  testCaseTitle("req_010__tpl_seed_replay_01", "Replayed SecurityAccess key for level 0x1 is rejected");
  // step 0: Switch to session 0x3.
  {
    byte req0[2] = {0x10, 0x03};
    byte exp0[6] = {0x50, 0x03, 0x00, 0x32, 0x01, 0xF4};
    SendAndCheck(req0, 2, exp0, 6, "step 0");
  }
  // step 1: Request seed.
  {
    byte req1[2] = {0x27, 0x01};
    byte exp1[6] = {0x67, 0x01, 0x95, 0x06, 0x77, 0xE8};
    SendAndCheck(req1, 2, exp1, 6, "step 1");
  }
  // step 2: Send the computed key -> unlocked.
  {
    byte req2[6] = {0x27, 0x02, 0x9A, 0x06, 0x8F, 0x73};
    byte exp2[2] = {0x67, 0x02};
    SendAndCheck(req2, 6, exp2, 2, "step 2");
  }
  // step 3: Replay the same key -> expect NRC 0x24 (the seed was consumed).
  {
    byte req3[6] = {0x27, 0x02, 0x9A, 0x06, 0x8F, 0x73};
    byte exp3[3] = {0x7F, 0x27, 0x24};
    SendAndCheck(req3, 6, exp3, 3, "step 3");
  }
}

/* SecurityAccess level 0x1 lockout after 3 wrong keys
 * category=security template=security_invalid_key_lockout requirements=REQ-010 origin=generated
 * Preconditions: ECU in extended session (0x03); No security level unlocked; 3 failed key attempt(s) on level 0x01
 * Pass criteria: All 10 requests must get exactly the expected bytes. Action under test: ECU replies 67 01 6C DD 4E BF (positive) within P2 = 50 ms.
 */
testcase TC_req_010__tpl_security_lockout_01()
{
  testCaseTitle("req_010__tpl_security_lockout_01", "SecurityAccess level 0x1 lockout after 3 wrong keys");
  // step 0: Switch to session 0x3.
  {
    byte req0[2] = {0x10, 0x03};
    byte exp0[6] = {0x50, 0x03, 0x00, 0x32, 0x01, 0xF4};
    SendAndCheck(req0, 2, exp0, 6, "step 0");
  }
  // step 1: Request seed, attempt 1.
  {
    byte req1[2] = {0x27, 0x01};
    byte exp1[6] = {0x67, 0x01, 0x95, 0x06, 0x77, 0xE8};
    SendAndCheck(req1, 2, exp1, 6, "step 1");
  }
  // step 2: Send wrong key, attempt 1.
  {
    byte req2[6] = {0x27, 0x02, 0x96, 0x07, 0x78, 0xE9};
    byte exp2[3] = {0x7F, 0x27, 0x35};
    SendAndCheck(req2, 6, exp2, 3, "step 2");
  }
  // step 3: Request seed, attempt 2.
  {
    byte req3[2] = {0x27, 0x01};
    byte exp3[6] = {0x67, 0x01, 0x32, 0xA3, 0x14, 0x85};
    SendAndCheck(req3, 2, exp3, 6, "step 3");
  }
  // step 4: Send wrong key, attempt 2.
  {
    byte req4[6] = {0x27, 0x02, 0x33, 0xA4, 0x15, 0x86};
    byte exp4[3] = {0x7F, 0x27, 0x35};
    SendAndCheck(req4, 6, exp4, 3, "step 4");
  }
  // step 5: Request seed, attempt 3.
  {
    byte req5[2] = {0x27, 0x01};
    byte exp5[6] = {0x67, 0x01, 0xCF, 0x40, 0xB1, 0x22};
    SendAndCheck(req5, 2, exp5, 6, "step 5");
  }
  // step 6: Send wrong key, attempt 3.
  {
    byte req6[6] = {0x27, 0x02, 0xD0, 0x41, 0xB2, 0x23};
    byte exp6[3] = {0x7F, 0x27, 0x36};
    SendAndCheck(req6, 6, exp6, 3, "step 6");
  }
  // step 7: Request seed during lockout -> expect NRC 0x37.
  {
    byte req7[2] = {0x27, 0x01};
    byte exp7[3] = {0x7F, 0x27, 0x37};
    SendAndCheck(req7, 2, exp7, 3, "step 7");
  }
  // step 8: Advance past the lockout delay.
  testWaitForTimeout(10001);
  // step 9: Re-enter the session (S3 expired during the wait).
  {
    byte req9[2] = {0x10, 0x03};
    byte exp9[6] = {0x50, 0x03, 0x00, 0x32, 0x01, 0xF4};
    SendAndCheck(req9, 2, exp9, 6, "step 9");
  }
  // step 10: Request seed after delay expiry -> seed issued again.
  {
    byte req10[2] = {0x27, 0x01};
    byte exp10[6] = {0x67, 0x01, 0x6C, 0xDD, 0x4E, 0xBF};
    SendAndCheck(req10, 2, exp10, 6, "step 10");
  }
}

/* Multi-DID read driver_door_lock_state + VIN in session 0x1
 * category=positive template=read_multiple_dids requirements=REQ-010 origin=generated
 * Preconditions: ECU in default session (0x01)
 * Pass criteria: ECU replies 62 01 10 01 F1 90 53 59 4E 54 48 45 54 49 43 42 4D 30 30 30 30 30 31 (positive) within P2 = 50 ms.
 */
testcase TC_req_010__tpl_read_multi_0110_f190_01()
{
  testCaseTitle("req_010__tpl_read_multi_0110_f190_01", "Multi-DID read driver_door_lock_state + VIN in session 0x1");
  // step 0: Read DIDs 0x0110, 0xf190 in one request -> every record, in order.
  {
    byte req0[5] = {0x22, 0x01, 0x10, 0xF1, 0x90};
    byte exp0[23] = {0x62, 0x01, 0x10, 0x01, 0xF1, 0x90, 0x53, 0x59, 0x4E, 0x54, 0x48, 0x45, 0x54, 0x49, 0x43, 0x42, 0x4D, 0x30, 0x30, 0x30, 0x30, 0x30, 0x31};
    SendAndCheck(req0, 5, exp0, 23, "step 0");
  }
}

/* Malformed-length reads of DID driver_door_lock_state (0x0110) are rejected
 * category=negative template=read_did_invalid_length requirements=REQ-010 origin=generated
 * Preconditions: ECU in default session (0x01)
 * Pass criteria: All 4 requests must get exactly the expected bytes. Action under test: ECU replies 62 01 10 01 (positive) within P2 = 50 ms.
 */
testcase TC_req_010__tpl_read_badlen_0110_01()
{
  testCaseTitle("req_010__tpl_read_badlen_0110_01", "Malformed-length reads of DID driver_door_lock_state (0x0110) are rejected");
  // step 0: ReadDataByIdentifier without any DID -> length NRC.
  {
    byte req0[1] = {0x22};
    byte exp0[3] = {0x7F, 0x22, 0x13};
    SendAndCheck(req0, 1, exp0, 3, "step 0");
  }
  // step 1: Only the first byte of DID 0x0110 -> length NRC.
  {
    byte req1[2] = {0x22, 0x01};
    byte exp1[3] = {0x7F, 0x22, 0x13};
    SendAndCheck(req1, 2, exp1, 3, "step 1");
  }
  // step 2: DID 0x0110 plus one dangling byte -> length NRC, no partial answer.
  {
    byte req2[4] = {0x22, 0x01, 0x10, 0x00};
    byte exp2[3] = {0x7F, 0x22, 0x13};
    SendAndCheck(req2, 4, exp2, 3, "step 2");
  }
  // step 3: Well-formed read of the same DID -> served normally.
  {
    byte req3[3] = {0x22, 0x01, 0x10};
    byte exp3[4] = {0x62, 0x01, 0x10, 0x01};
    SendAndCheck(req3, 3, exp3, 4, "step 3");
  }
}

/* Session change re-locks security level 0x3
 * category=security template=session_change_relocks_security requirements=REQ-010 origin=generated
 * Preconditions: ECU in programming session (0x02); No security level unlocked
 * Pass criteria: All 6 requests must get exactly the expected bytes. Action under test: ECU replies 67 03 A8 19 8A FB (positive) within P2 = 50 ms.
 */
testcase TC_req_010__tpl_session_relock_03()
{
  testCaseTitle("req_010__tpl_session_relock_03", "Session change re-locks security level 0x3");
  // step 0: Switch to session 0x2.
  {
    byte req0[2] = {0x10, 0x02};
    byte exp0[6] = {0x50, 0x02, 0x00, 0x32, 0x01, 0xF4};
    SendAndCheck(req0, 2, exp0, 6, "step 0");
  }
  // step 1: Request seed for level 0x3.
  {
    byte req1[2] = {0x27, 0x03};
    byte exp1[6] = {0x67, 0x03, 0x0B, 0x7C, 0xED, 0x5E};
    SendAndCheck(req1, 2, exp1, 6, "step 1");
  }
  // step 2: Send computed key for level 0x3.
  {
    byte req2[6] = {0x27, 0x04, 0x20, 0xA9, 0x2D, 0xBA};
    byte exp2[2] = {0x67, 0x04};
    SendAndCheck(req2, 6, exp2, 2, "step 2");
  }
  // step 3: Re-enter the same session -> security must be locked again.
  {
    byte req3[2] = {0x10, 0x02};
    byte exp3[6] = {0x50, 0x02, 0x00, 0x32, 0x01, 0xF4};
    SendAndCheck(req3, 2, exp3, 6, "step 3");
  }
  // step 4: Secured write to 0x0160 after re-entry -> expect NRC 0x33.
  {
    byte req4[5] = {0x2E, 0x01, 0x60, 0x00, 0x00};
    byte exp4[3] = {0x7F, 0x2E, 0x33};
    SendAndCheck(req4, 5, exp4, 3, "step 4");
  }
  // step 5: Request seed -> a fresh non-zero seed (level is locked again).
  {
    byte req5[2] = {0x27, 0x03};
    byte exp5[6] = {0x67, 0x03, 0xA8, 0x19, 0x8A, 0xFB};
    SendAndCheck(req5, 2, exp5, 6, "step 5");
  }
}


/* Test module entry point: runs every exported test case. */
void MainTest()
{
  TC_req_010__tpl_read_badlen_0110_01();
  TC_req_010__tpl_read_did_positive_0110_01();
  TC_req_010__tpl_read_multi_0110_f190_01();
  TC_req_010__tpl_security_lockout_01();
  TC_req_010__tpl_seed_replay_01();
  TC_req_010__tpl_seed_while_unlocked_03();
  TC_req_010__tpl_service_not_in_session_27_01();
  TC_req_010__tpl_session_relock_03();
}
