/*
 * UNVERIFIED TEMPLATE — not compiled or run in CANoe
 *
 * Generated by uds_assistant.export.to_capl from 60 test case(s).
 * Request/response bytes are copied verbatim from the test cases (templates +
 * rules-engine oracle, or the hand-written gold set). The ECU spec is SYNTHETIC.
 * Adapt the diagnostic target / CDD binding before use; review every test.
 */

includes
{
}

variables
{
  const dword kP2TimeoutMs = 2000;      // generous tester-side timeout per request
  const dword kSilenceWaitMs = 300;     // wait used when no response is expected
}

/* Send raw request bytes and compare the final response with the expected bytes.
 * expectedLen == 0 means "no response expected" (suppressed positive response). */
int SendAndCheck(byte req[], dword reqLen, byte expected[], dword expectedLen, char stepName[])
{
  diagRequest * rawReq;
  diagResponse * rawResp;
  dword i;
  long waitResult;
  byte actual[4095];
  long actualLen;

  diagResize(rawReq, reqLen);
  for (i = 0; i < reqLen; i++)
    diagSetPrimitiveByte(rawReq, i, req[i]);
  diagSendRequest(rawReq);

  if (expectedLen == 0)
  {
    waitResult = testWaitForDiagResponse(rawReq, kSilenceWaitMs);
    if (waitResult == 1)
    {
      testStepFail(stepName, "Unexpected response (positive response should be suppressed)");
      return 0;
    }
    testStepPass(stepName, "No response, as expected");
    return 1;
  }

  waitResult = testWaitForDiagResponse(rawReq, kP2TimeoutMs);
  if (waitResult != 1)
  {
    testStepFail(stepName, "No response within timeout");
    return 0;
  }
  diagGetLastResponse(rawReq, rawResp);
  actualLen = diagGetPrimitiveSize(rawResp);
  if (actualLen != expectedLen)
  {
    testStepFail(stepName, "Response length %d, expected %d", actualLen, expectedLen);
    return 0;
  }
  for (i = 0; i < expectedLen; i++)
  {
    actual[i] = diagGetPrimitiveByte(rawResp, i);
    if (actual[i] != expected[i])
    {
      testStepFail(stepName, "Byte %d is 0x%02X, expected 0x%02X", i, actual[i], expected[i]);
      return 0;
    }
  }
  testStepPass(stepName, "Response matches");
  return 1;
}


/* Read VIN in default session
 * category=positive template=None requirements=REQ-001 origin=gold
 */
testcase TC_gold_read_vin_default()
{
  testCaseTitle("gold_read_vin_default", "Read VIN in default session");
  // step 0: send request
  {
    byte req0[3] = {0x22, 0xF1, 0x90};
    byte exp0[20] = {0x62, 0xF1, 0x90, 0x53, 0x59, 0x4E, 0x54, 0x48, 0x45, 0x54, 0x49, 0x43, 0x42, 0x4D, 0x30, 0x30, 0x30, 0x30, 0x30, 0x31};
    SendAndCheck(req0, 3, exp0, 20, "step 0");
  }
}

/* Read VIN in extended session
 * category=positive template=None requirements=REQ-001 origin=gold
 */
testcase TC_gold_read_vin_extended()
{
  testCaseTitle("gold_read_vin_extended", "Read VIN in extended session");
  // step 0: send request
  {
    byte req0[2] = {0x10, 0x03};
    byte exp0[6] = {0x50, 0x03, 0x00, 0x32, 0x01, 0xF4};
    SendAndCheck(req0, 2, exp0, 6, "step 0");
  }
  // step 1: send request
  {
    byte req1[3] = {0x22, 0xF1, 0x90};
    byte exp1[20] = {0x62, 0xF1, 0x90, 0x53, 0x59, 0x4E, 0x54, 0x48, 0x45, 0x54, 0x49, 0x43, 0x42, 0x4D, 0x30, 0x30, 0x30, 0x30, 0x30, 0x31};
    SendAndCheck(req1, 3, exp1, 20, "step 1");
  }
}

/* Multi-DID read: part number + serial
 * category=positive template=None requirements=REQ-002 origin=gold
 */
testcase TC_gold_read_partnum_serial_multi()
{
  testCaseTitle("gold_read_partnum_serial_multi", "Multi-DID read: part number + serial");
  // step 0: send request
  {
    byte req0[5] = {0x22, 0xF1, 0x87, 0xF1, 0x8C};
    byte exp0[23] = {0x62, 0xF1, 0x87, 0x42, 0x43, 0x4D, 0x2D, 0x31, 0x32, 0x33, 0x34, 0x35, 0x2D, 0xF1, 0x8C, 0x53, 0x45, 0x30, 0x30, 0x30, 0x30, 0x30, 0x31};
    SendAndCheck(req0, 5, exp0, 23, "step 0");
  }
}

/* Read an unknown DID
 * category=negative template=None requirements=REQ-001 origin=gold
 */
testcase TC_gold_read_unknown_did()
{
  testCaseTitle("gold_read_unknown_did", "Read an unknown DID");
  // step 0: send request
  {
    byte req0[3] = {0x22, 0x99, 0x99};
    byte exp0[3] = {0x7F, 0x22, 0x31};
    SendAndCheck(req0, 3, exp0, 3, "step 0");
  }
}

/* Session control: default -> extended
 * category=session template=None requirements=REQ-003 origin=gold
 */
testcase TC_gold_session_to_extended()
{
  testCaseTitle("gold_session_to_extended", "Session control: default -> extended");
  // step 0: send request
  {
    byte req0[2] = {0x10, 0x03};
    byte exp0[6] = {0x50, 0x03, 0x00, 0x32, 0x01, 0xF4};
    SendAndCheck(req0, 2, exp0, 6, "step 0");
  }
}

/* Session control: extended -> default
 * category=session template=None requirements=REQ-003 origin=gold
 */
testcase TC_gold_session_back_default()
{
  testCaseTitle("gold_session_back_default", "Session control: extended -> default");
  // step 0: send request
  {
    byte req0[2] = {0x10, 0x03};
    byte exp0[6] = {0x50, 0x03, 0x00, 0x32, 0x01, 0xF4};
    SendAndCheck(req0, 2, exp0, 6, "step 0");
  }
  // step 1: send request
  {
    byte req1[2] = {0x10, 0x01};
    byte exp1[6] = {0x50, 0x01, 0x00, 0x32, 0x01, 0xF4};
    SendAndCheck(req1, 2, exp1, 6, "step 1");
  }
}

/* Session control: default -> programming
 * category=session template=None requirements=REQ-004 origin=gold
 */
testcase TC_gold_session_programming()
{
  testCaseTitle("gold_session_programming", "Session control: default -> programming");
  // step 0: send request
  {
    byte req0[2] = {0x10, 0x02};
    byte exp0[6] = {0x50, 0x02, 0x00, 0x32, 0x01, 0xF4};
    SendAndCheck(req0, 2, exp0, 6, "step 0");
  }
}

/* Session control with unsupported subfunction
 * category=negative template=None requirements=REQ-003 origin=gold
 */
testcase TC_gold_session_unsupported_sub()
{
  testCaseTitle("gold_session_unsupported_sub", "Session control with unsupported subfunction");
  // step 0: send request
  {
    byte req0[2] = {0x10, 0x05};
    byte exp0[3] = {0x7F, 0x10, 0x12};
    SendAndCheck(req0, 2, exp0, 3, "step 0");
  }
}

/* Session control with extra byte
 * category=negative template=None requirements=REQ-003 origin=gold
 */
testcase TC_gold_session_wrong_length()
{
  testCaseTitle("gold_session_wrong_length", "Session control with extra byte");
  // step 0: send request
  {
    byte req0[3] = {0x10, 0x03, 0x00};
    byte exp0[3] = {0x7F, 0x10, 0x13};
    SendAndCheck(req0, 3, exp0, 3, "step 0");
  }
}

/* ECU hard reset
 * category=positive template=None requirements=REQ-013 origin=gold
 */
testcase TC_gold_ecu_reset_hard()
{
  testCaseTitle("gold_ecu_reset_hard", "ECU hard reset");
  // step 0: send request
  {
    byte req0[2] = {0x11, 0x01};
    byte exp0[2] = {0x51, 0x01};
    SendAndCheck(req0, 2, exp0, 2, "step 0");
  }
}

/* ECU soft reset
 * category=positive template=None requirements=REQ-013 origin=gold
 */
testcase TC_gold_ecu_reset_soft()
{
  testCaseTitle("gold_ecu_reset_soft", "ECU soft reset");
  // step 0: send request
  {
    byte req0[2] = {0x11, 0x03};
    byte exp0[2] = {0x51, 0x03};
    SendAndCheck(req0, 2, exp0, 2, "step 0");
  }
}

/* ECU reset with unsupported subfunction
 * category=negative template=None requirements=REQ-013 origin=gold
 */
testcase TC_gold_ecu_reset_bad_sub()
{
  testCaseTitle("gold_ecu_reset_bad_sub", "ECU reset with unsupported subfunction");
  // step 0: send request
  {
    byte req0[2] = {0x11, 0x02};
    byte exp0[3] = {0x7F, 0x11, 0x12};
    SendAndCheck(req0, 2, exp0, 3, "step 0");
  }
}

/* SecurityAccess not allowed in default session
 * category=session template=None requirements=- origin=gold
 */
testcase TC_gold_security_not_allowed_default_session()
{
  testCaseTitle("gold_security_not_allowed_default_session", "SecurityAccess not allowed in default session");
  // step 0: send request
  {
    byte req0[2] = {0x27, 0x01};
    byte exp0[3] = {0x7F, 0x27, 0x7F};
    SendAndCheck(req0, 2, exp0, 3, "step 0");
  }
}

/* Completely unsupported service id
 * category=negative template=None requirements=- origin=gold
 */
testcase TC_gold_unsupported_sid()
{
  testCaseTitle("gold_unsupported_sid", "Completely unsupported service id");
  // step 0: send request
  {
    byte req0[2] = {0x2F, 0x01};
    byte exp0[3] = {0x7F, 0x2F, 0x11};
    SendAndCheck(req0, 2, exp0, 3, "step 0");
  }
}

/* Write secured DID without unlocking
 * category=security template=None requirements=REQ-005 origin=gold
 */
testcase TC_gold_write_without_unlock()
{
  testCaseTitle("gold_write_without_unlock", "Write secured DID without unlocking");
  // step 0: send request
  {
    byte req0[2] = {0x10, 0x03};
    byte exp0[6] = {0x50, 0x03, 0x00, 0x32, 0x01, 0xF4};
    SendAndCheck(req0, 2, exp0, 6, "step 0");
  }
  // step 1: send request
  {
    byte req1[4] = {0x2E, 0x01, 0x00, 0x14};
    byte exp1[3] = {0x7F, 0x2E, 0x33};
    SendAndCheck(req1, 4, exp1, 3, "step 1");
  }
}

/* Unlock level 1, write & read back lighting brightness
 * category=positive template=None requirements=REQ-005 origin=gold
 */
testcase TC_gold_write_secured_positive_lighting()
{
  testCaseTitle("gold_write_secured_positive_lighting", "Unlock level 1, write & read back lighting brightness");
  // step 0: send request
  {
    byte req0[2] = {0x10, 0x03};
    byte exp0[6] = {0x50, 0x03, 0x00, 0x32, 0x01, 0xF4};
    SendAndCheck(req0, 2, exp0, 6, "step 0");
  }
  // step 1: send request
  {
    byte req1[2] = {0x27, 0x01};
    byte exp1[6] = {0x67, 0x01, 0x95, 0x06, 0x77, 0xE8};
    SendAndCheck(req1, 2, exp1, 6, "step 1");
  }
  // step 2: send request
  {
    byte req2[6] = {0x27, 0x02, 0x9A, 0x06, 0x8F, 0x73};
    byte exp2[2] = {0x67, 0x02};
    SendAndCheck(req2, 6, exp2, 2, "step 2");
  }
  // step 3: send request
  {
    byte req3[4] = {0x2E, 0x01, 0x00, 0x14};
    byte exp3[3] = {0x6E, 0x01, 0x00};
    SendAndCheck(req3, 4, exp3, 3, "step 3");
  }
  // step 4: send request
  {
    byte req4[3] = {0x22, 0x01, 0x00};
    byte exp4[4] = {0x62, 0x01, 0x00, 0x14};
    SendAndCheck(req4, 3, exp4, 4, "step 4");
  }
}

/* Unlock level 1, write ambient color to max
 * category=positive template=None requirements=REQ-006 origin=gold
 */
testcase TC_gold_write_secured_positive_ambient_color()
{
  testCaseTitle("gold_write_secured_positive_ambient_color", "Unlock level 1, write ambient color to max");
  // step 0: send request
  {
    byte req0[2] = {0x10, 0x03};
    byte exp0[6] = {0x50, 0x03, 0x00, 0x32, 0x01, 0xF4};
    SendAndCheck(req0, 2, exp0, 6, "step 0");
  }
  // step 1: send request
  {
    byte req1[2] = {0x27, 0x01};
    byte exp1[6] = {0x67, 0x01, 0x95, 0x06, 0x77, 0xE8};
    SendAndCheck(req1, 2, exp1, 6, "step 1");
  }
  // step 2: send request
  {
    byte req2[6] = {0x27, 0x02, 0x9A, 0x06, 0x8F, 0x73};
    byte exp2[2] = {0x67, 0x02};
    SendAndCheck(req2, 6, exp2, 2, "step 2");
  }
  // step 3: send request
  {
    byte req3[4] = {0x2E, 0x01, 0x01, 0x0F};
    byte exp3[3] = {0x6E, 0x01, 0x01};
    SendAndCheck(req3, 4, exp3, 3, "step 3");
  }
  // step 4: send request
  {
    byte req4[3] = {0x22, 0x01, 0x01};
    byte exp4[4] = {0x62, 0x01, 0x01, 0x0F};
    SendAndCheck(req4, 3, exp4, 4, "step 4");
  }
}

/* Write wiper sensitivity above max
 * category=negative template=None requirements=REQ-007 origin=gold
 */
testcase TC_gold_write_out_of_range_wiper()
{
  testCaseTitle("gold_write_out_of_range_wiper", "Write wiper sensitivity above max");
  // step 0: send request
  {
    byte req0[2] = {0x10, 0x03};
    byte exp0[6] = {0x50, 0x03, 0x00, 0x32, 0x01, 0xF4};
    SendAndCheck(req0, 2, exp0, 6, "step 0");
  }
  // step 1: send request
  {
    byte req1[2] = {0x27, 0x01};
    byte exp1[6] = {0x67, 0x01, 0x95, 0x06, 0x77, 0xE8};
    SendAndCheck(req1, 2, exp1, 6, "step 1");
  }
  // step 2: send request
  {
    byte req2[6] = {0x27, 0x02, 0x9A, 0x06, 0x8F, 0x73};
    byte exp2[2] = {0x67, 0x02};
    SendAndCheck(req2, 6, exp2, 2, "step 2");
  }
  // step 3: send request
  {
    byte req3[4] = {0x2E, 0x01, 0x30, 0x06};
    byte exp3[3] = {0x7F, 0x2E, 0x31};
    SendAndCheck(req3, 4, exp3, 3, "step 3");
  }
}

/* Write brightness above 100
 * category=negative template=None requirements=REQ-008 origin=gold
 */
testcase TC_gold_write_out_of_range_brightness()
{
  testCaseTitle("gold_write_out_of_range_brightness", "Write brightness above 100");
  // step 0: send request
  {
    byte req0[2] = {0x10, 0x03};
    byte exp0[6] = {0x50, 0x03, 0x00, 0x32, 0x01, 0xF4};
    SendAndCheck(req0, 2, exp0, 6, "step 0");
  }
  // step 1: send request
  {
    byte req1[2] = {0x27, 0x01};
    byte exp1[6] = {0x67, 0x01, 0x95, 0x06, 0x77, 0xE8};
    SendAndCheck(req1, 2, exp1, 6, "step 1");
  }
  // step 2: send request
  {
    byte req2[6] = {0x27, 0x02, 0x9A, 0x06, 0x8F, 0x73};
    byte exp2[2] = {0x67, 0x02};
    SendAndCheck(req2, 6, exp2, 2, "step 2");
  }
  // step 3: send request
  {
    byte req3[4] = {0x2E, 0x01, 0x00, 0x65};
    byte exp3[3] = {0x7F, 0x2E, 0x31};
    SendAndCheck(req3, 4, exp3, 3, "step 3");
  }
}

/* Write brightness with wrong data length
 * category=negative template=None requirements=REQ-005 origin=gold
 */
testcase TC_gold_write_wrong_length()
{
  testCaseTitle("gold_write_wrong_length", "Write brightness with wrong data length");
  // step 0: send request
  {
    byte req0[2] = {0x10, 0x03};
    byte exp0[6] = {0x50, 0x03, 0x00, 0x32, 0x01, 0xF4};
    SendAndCheck(req0, 2, exp0, 6, "step 0");
  }
  // step 1: send request
  {
    byte req1[5] = {0x2E, 0x01, 0x00, 0x00, 0x14};
    byte exp1[3] = {0x7F, 0x2E, 0x13};
    SendAndCheck(req1, 5, exp1, 3, "step 1");
  }
}

/* Write a read-only DID
 * category=negative template=None requirements=- origin=gold
 */
testcase TC_gold_write_readonly_did()
{
  testCaseTitle("gold_write_readonly_did", "Write a read-only DID");
  // step 0: send request
  {
    byte req0[2] = {0x10, 0x03};
    byte exp0[6] = {0x50, 0x03, 0x00, 0x32, 0x01, 0xF4};
    SendAndCheck(req0, 2, exp0, 6, "step 0");
  }
  // step 1: send request
  {
    byte req1[2] = {0x27, 0x01};
    byte exp1[6] = {0x67, 0x01, 0x95, 0x06, 0x77, 0xE8};
    SendAndCheck(req1, 2, exp1, 6, "step 1");
  }
  // step 2: send request
  {
    byte req2[6] = {0x27, 0x02, 0x9A, 0x06, 0x8F, 0x73};
    byte exp2[2] = {0x67, 0x02};
    SendAndCheck(req2, 6, exp2, 2, "step 2");
  }
  // step 3: send request
  {
    byte req3[4] = {0x2E, 0x01, 0x10, 0x00};
    byte exp3[3] = {0x7F, 0x2E, 0x31};
    SendAndCheck(req3, 4, exp3, 3, "step 3");
  }
}

/* Write an unknown DID
 * category=negative template=None requirements=- origin=gold
 */
testcase TC_gold_write_unknown_did()
{
  testCaseTitle("gold_write_unknown_did", "Write an unknown DID");
  // step 0: send request
  {
    byte req0[2] = {0x10, 0x03};
    byte exp0[6] = {0x50, 0x03, 0x00, 0x32, 0x01, 0xF4};
    SendAndCheck(req0, 2, exp0, 6, "step 0");
  }
  // step 1: send request
  {
    byte req1[4] = {0x2E, 0x99, 0x99, 0x00};
    byte exp1[3] = {0x7F, 0x2E, 0x31};
    SendAndCheck(req1, 4, exp1, 3, "step 1");
  }
}

/* Request seed for level 1
 * category=positive template=None requirements=- origin=gold
 */
testcase TC_gold_security_seed_level1()
{
  testCaseTitle("gold_security_seed_level1", "Request seed for level 1");
  // step 0: send request
  {
    byte req0[2] = {0x10, 0x03};
    byte exp0[6] = {0x50, 0x03, 0x00, 0x32, 0x01, 0xF4};
    SendAndCheck(req0, 2, exp0, 6, "step 0");
  }
  // step 1: send request
  {
    byte req1[2] = {0x27, 0x01};
    byte exp1[6] = {0x67, 0x01, 0x95, 0x06, 0x77, 0xE8};
    SendAndCheck(req1, 2, exp1, 6, "step 1");
  }
}

/* Send one wrong key
 * category=security template=None requirements=REQ-010 origin=gold
 */
testcase TC_gold_security_wrong_key_once()
{
  testCaseTitle("gold_security_wrong_key_once", "Send one wrong key");
  // step 0: send request
  {
    byte req0[2] = {0x10, 0x03};
    byte exp0[6] = {0x50, 0x03, 0x00, 0x32, 0x01, 0xF4};
    SendAndCheck(req0, 2, exp0, 6, "step 0");
  }
  // step 1: send request
  {
    byte req1[2] = {0x27, 0x01};
    byte exp1[6] = {0x67, 0x01, 0x95, 0x06, 0x77, 0xE8};
    SendAndCheck(req1, 2, exp1, 6, "step 1");
  }
  // step 2: send request
  {
    byte req2[6] = {0x27, 0x02, 0x00, 0x00, 0x00, 0x00};
    byte exp2[3] = {0x7F, 0x27, 0x35};
    SendAndCheck(req2, 6, exp2, 3, "step 2");
  }
}

/* Lockout after 3 wrong keys, then 0x37
 * category=security template=None requirements=REQ-010 origin=gold
 */
testcase TC_gold_security_lockout_after_3()
{
  testCaseTitle("gold_security_lockout_after_3", "Lockout after 3 wrong keys, then 0x37");
  // step 0: send request
  {
    byte req0[2] = {0x10, 0x03};
    byte exp0[6] = {0x50, 0x03, 0x00, 0x32, 0x01, 0xF4};
    SendAndCheck(req0, 2, exp0, 6, "step 0");
  }
  // step 1: send request
  {
    byte req1[2] = {0x27, 0x01};
    byte exp1[6] = {0x67, 0x01, 0x95, 0x06, 0x77, 0xE8};
    SendAndCheck(req1, 2, exp1, 6, "step 1");
  }
  // step 2: send request
  {
    byte req2[6] = {0x27, 0x02, 0x00, 0x00, 0x00, 0x00};
    byte exp2[3] = {0x7F, 0x27, 0x35};
    SendAndCheck(req2, 6, exp2, 3, "step 2");
  }
  // step 3: send request
  {
    byte req3[2] = {0x27, 0x01};
    byte exp3[6] = {0x67, 0x01, 0x32, 0xA3, 0x14, 0x85};
    SendAndCheck(req3, 2, exp3, 6, "step 3");
  }
  // step 4: send request
  {
    byte req4[6] = {0x27, 0x02, 0x00, 0x00, 0x00, 0x00};
    byte exp4[3] = {0x7F, 0x27, 0x35};
    SendAndCheck(req4, 6, exp4, 3, "step 4");
  }
  // step 5: send request
  {
    byte req5[2] = {0x27, 0x01};
    byte exp5[6] = {0x67, 0x01, 0xCF, 0x40, 0xB1, 0x22};
    SendAndCheck(req5, 2, exp5, 6, "step 5");
  }
  // step 6: send request
  {
    byte req6[6] = {0x27, 0x02, 0x00, 0x00, 0x00, 0x00};
    byte exp6[3] = {0x7F, 0x27, 0x36};
    SendAndCheck(req6, 6, exp6, 3, "step 6");
  }
  // step 7: send request
  {
    byte req7[2] = {0x27, 0x01};
    byte exp7[3] = {0x7F, 0x27, 0x37};
    SendAndCheck(req7, 2, exp7, 3, "step 7");
  }
}

/* Send key with no pending seed
 * category=negative template=None requirements=- origin=gold
 */
testcase TC_gold_security_key_without_seed()
{
  testCaseTitle("gold_security_key_without_seed", "Send key with no pending seed");
  // step 0: send request
  {
    byte req0[2] = {0x10, 0x03};
    byte exp0[6] = {0x50, 0x03, 0x00, 0x32, 0x01, 0xF4};
    SendAndCheck(req0, 2, exp0, 6, "step 0");
  }
  // step 1: send request
  {
    byte req1[6] = {0x27, 0x02, 0x00, 0x00, 0x00, 0x00};
    byte exp1[3] = {0x7F, 0x27, 0x24};
    SendAndCheck(req1, 6, exp1, 3, "step 1");
  }
}

/* Level 3 subfunction not allowed in extended session
 * category=session template=None requirements=- origin=gold
 */
testcase TC_gold_security_level3_subfunction_wrong_session()
{
  testCaseTitle("gold_security_level3_subfunction_wrong_session", "Level 3 subfunction not allowed in extended session");
  // step 0: send request
  {
    byte req0[2] = {0x10, 0x03};
    byte exp0[6] = {0x50, 0x03, 0x00, 0x32, 0x01, 0xF4};
    SendAndCheck(req0, 2, exp0, 6, "step 0");
  }
  // step 1: send request
  {
    byte req1[2] = {0x27, 0x03};
    byte exp1[3] = {0x7F, 0x27, 0x7E};
    SendAndCheck(req1, 2, exp1, 3, "step 1");
  }
}

/* Start door calibration routine without unlocking
 * category=security template=None requirements=- origin=gold
 */
testcase TC_gold_routine_start_without_security()
{
  testCaseTitle("gold_routine_start_without_security", "Start door calibration routine without unlocking");
  // step 0: send request
  {
    byte req0[2] = {0x10, 0x03};
    byte exp0[6] = {0x50, 0x03, 0x00, 0x32, 0x01, 0xF4};
    SendAndCheck(req0, 2, exp0, 6, "step 0");
  }
  // step 1: send request
  {
    byte req1[5] = {0x31, 0x01, 0x02, 0x02, 0x00};
    byte exp1[3] = {0x7F, 0x31, 0x33};
    SendAndCheck(req1, 5, exp1, 3, "step 1");
  }
}

/* Full lighting self-test routine sequence
 * category=positive template=None requirements=REQ-011 origin=gold
 */
testcase TC_gold_routine_lighting_full_sequence()
{
  testCaseTitle("gold_routine_lighting_full_sequence", "Full lighting self-test routine sequence");
  // step 0: send request
  {
    byte req0[2] = {0x10, 0x03};
    byte exp0[6] = {0x50, 0x03, 0x00, 0x32, 0x01, 0xF4};
    SendAndCheck(req0, 2, exp0, 6, "step 0");
  }
  // step 1: send request
  {
    byte req1[2] = {0x27, 0x01};
    byte exp1[6] = {0x67, 0x01, 0x95, 0x06, 0x77, 0xE8};
    SendAndCheck(req1, 2, exp1, 6, "step 1");
  }
  // step 2: send request
  {
    byte req2[6] = {0x27, 0x02, 0x9A, 0x06, 0x8F, 0x73};
    byte exp2[2] = {0x67, 0x02};
    SendAndCheck(req2, 6, exp2, 2, "step 2");
  }
  // step 3: send request
  {
    byte req3[4] = {0x31, 0x01, 0x02, 0x01};
    byte exp3[5] = {0x71, 0x01, 0x02, 0x01, 0x01};
    SendAndCheck(req3, 4, exp3, 5, "step 3");
  }
  // step 4: send request
  {
    byte req4[4] = {0x31, 0x02, 0x02, 0x01};
    byte exp4[5] = {0x71, 0x02, 0x02, 0x01, 0x03};
    SendAndCheck(req4, 4, exp4, 5, "step 4");
  }
  // step 5: send request
  {
    byte req5[4] = {0x31, 0x01, 0x02, 0x01};
    byte exp5[5] = {0x71, 0x01, 0x02, 0x01, 0x01};
    SendAndCheck(req5, 4, exp5, 5, "step 5");
  }
  // step 6: send request
  {
    byte req6[4] = {0x31, 0x03, 0x02, 0x01};
    byte exp6[5] = {0x71, 0x03, 0x02, 0x01, 0x01};
    SendAndCheck(req6, 4, exp6, 5, "step 6");
  }
}

/* Stop lighting routine before it started
 * category=negative template=None requirements=REQ-011 origin=gold
 */
testcase TC_gold_routine_stop_before_start()
{
  testCaseTitle("gold_routine_stop_before_start", "Stop lighting routine before it started");
  // step 0: send request
  {
    byte req0[2] = {0x10, 0x03};
    byte exp0[6] = {0x50, 0x03, 0x00, 0x32, 0x01, 0xF4};
    SendAndCheck(req0, 2, exp0, 6, "step 0");
  }
  // step 1: send request
  {
    byte req1[2] = {0x27, 0x01};
    byte exp1[6] = {0x67, 0x01, 0x95, 0x06, 0x77, 0xE8};
    SendAndCheck(req1, 2, exp1, 6, "step 1");
  }
  // step 2: send request
  {
    byte req2[6] = {0x27, 0x02, 0x9A, 0x06, 0x8F, 0x73};
    byte exp2[2] = {0x67, 0x02};
    SendAndCheck(req2, 6, exp2, 2, "step 2");
  }
  // step 3: send request
  {
    byte req3[4] = {0x31, 0x02, 0x02, 0x01};
    byte exp3[3] = {0x7F, 0x31, 0x24};
    SendAndCheck(req3, 4, exp3, 3, "step 3");
  }
}

/* Request lighting routine results before start
 * category=negative template=None requirements=REQ-011 origin=gold
 */
testcase TC_gold_routine_results_before_start()
{
  testCaseTitle("gold_routine_results_before_start", "Request lighting routine results before start");
  // step 0: send request
  {
    byte req0[2] = {0x10, 0x03};
    byte exp0[6] = {0x50, 0x03, 0x00, 0x32, 0x01, 0xF4};
    SendAndCheck(req0, 2, exp0, 6, "step 0");
  }
  // step 1: send request
  {
    byte req1[2] = {0x27, 0x01};
    byte exp1[6] = {0x67, 0x01, 0x95, 0x06, 0x77, 0xE8};
    SendAndCheck(req1, 2, exp1, 6, "step 1");
  }
  // step 2: send request
  {
    byte req2[6] = {0x27, 0x02, 0x9A, 0x06, 0x8F, 0x73};
    byte exp2[2] = {0x67, 0x02};
    SendAndCheck(req2, 6, exp2, 2, "step 2");
  }
  // step 3: send request
  {
    byte req3[4] = {0x31, 0x03, 0x02, 0x01};
    byte exp3[3] = {0x7F, 0x31, 0x24};
    SendAndCheck(req3, 4, exp3, 3, "step 3");
  }
}

/* Start door calibration while vehicle moving
 * category=negative template=None requirements=REQ-012 origin=gold
 */
testcase TC_gold_routine_door_cal_condition_fail()
{
  testCaseTitle("gold_routine_door_cal_condition_fail", "Start door calibration while vehicle moving");
  // step 0: send request
  {
    byte req0[2] = {0x10, 0x03};
    byte exp0[6] = {0x50, 0x03, 0x00, 0x32, 0x01, 0xF4};
    SendAndCheck(req0, 2, exp0, 6, "step 0");
  }
  // step 1: send request
  {
    byte req1[2] = {0x27, 0x01};
    byte exp1[6] = {0x67, 0x01, 0x95, 0x06, 0x77, 0xE8};
    SendAndCheck(req1, 2, exp1, 6, "step 1");
  }
  // step 2: send request
  {
    byte req2[6] = {0x27, 0x02, 0x9A, 0x06, 0x8F, 0x73};
    byte exp2[2] = {0x67, 0x02};
    SendAndCheck(req2, 6, exp2, 2, "step 2");
  }
  // step 3: TODO set environment on the bench: vehicle_speed_kph=10 nvm_write_fault=None
  // step 4: send request
  {
    byte req4[5] = {0x31, 0x01, 0x02, 0x02, 0x00};
    byte exp4[3] = {0x7F, 0x31, 0x22};
    SendAndCheck(req4, 5, exp4, 3, "step 4");
  }
}

/* Start door calibration while stationary
 * category=positive template=None requirements=REQ-012 origin=gold
 */
testcase TC_gold_routine_door_cal_positive()
{
  testCaseTitle("gold_routine_door_cal_positive", "Start door calibration while stationary");
  // step 0: send request
  {
    byte req0[2] = {0x10, 0x03};
    byte exp0[6] = {0x50, 0x03, 0x00, 0x32, 0x01, 0xF4};
    SendAndCheck(req0, 2, exp0, 6, "step 0");
  }
  // step 1: send request
  {
    byte req1[2] = {0x27, 0x01};
    byte exp1[6] = {0x67, 0x01, 0x95, 0x06, 0x77, 0xE8};
    SendAndCheck(req1, 2, exp1, 6, "step 1");
  }
  // step 2: send request
  {
    byte req2[6] = {0x27, 0x02, 0x9A, 0x06, 0x8F, 0x73};
    byte exp2[2] = {0x67, 0x02};
    SendAndCheck(req2, 6, exp2, 2, "step 2");
  }
  // step 3: send request
  {
    byte req3[5] = {0x31, 0x01, 0x02, 0x02, 0x00};
    byte exp3[5] = {0x71, 0x01, 0x02, 0x02, 0x01};
    SendAndCheck(req3, 5, exp3, 5, "step 3");
  }
}

/* Long-running NVM factory restore start
 * category=timing template=None requirements=- origin=gold
 */
testcase TC_gold_routine_nvm_restore_long_running()
{
  testCaseTitle("gold_routine_nvm_restore_long_running", "Long-running NVM factory restore start");
  // step 0: send request
  {
    byte req0[2] = {0x10, 0x02};
    byte exp0[6] = {0x50, 0x02, 0x00, 0x32, 0x01, 0xF4};
    SendAndCheck(req0, 2, exp0, 6, "step 0");
  }
  // step 1: send request
  {
    byte req1[2] = {0x27, 0x03};
    byte exp1[6] = {0x67, 0x03, 0x0B, 0x7C, 0xED, 0x5E};
    SendAndCheck(req1, 2, exp1, 6, "step 1");
  }
  // step 2: send request
  {
    byte req2[6] = {0x27, 0x04, 0x20, 0xA9, 0x2D, 0xBA};
    byte exp2[2] = {0x67, 0x04};
    SendAndCheck(req2, 6, exp2, 2, "step 2");
  }
  // step 3: send request
  {
    byte req3[4] = {0x31, 0x01, 0x02, 0x03};
    // interim frame(s) expected first: 7F 31 78 (response pending; handled by the diag layer)
    byte exp3[5] = {0x71, 0x01, 0x02, 0x03, 0x02};
    SendAndCheck(req3, 4, exp3, 5, "step 3");
  }
}

/* NVM restore attempted in default session
 * category=session template=None requirements=- origin=gold
 */
testcase TC_gold_routine_nvm_restore_wrong_session()
{
  testCaseTitle("gold_routine_nvm_restore_wrong_session", "NVM restore attempted in default session");
  // step 0: send request
  {
    byte req0[4] = {0x31, 0x01, 0x02, 0x03};
    byte exp0[3] = {0x7F, 0x31, 0x7F};
    SendAndCheck(req0, 4, exp0, 3, "step 0");
  }
}

/* Read DTCs by status mask at power-on
 * category=positive template=None requirements=REQ-014 origin=gold
 */
testcase TC_gold_dtc_read_default()
{
  testCaseTitle("gold_dtc_read_default", "Read DTCs by status mask at power-on");
  // step 0: send request
  {
    byte req0[3] = {0x19, 0x02, 0xFF};
    byte exp0[3] = {0x59, 0x02, 0xFF};
    SendAndCheck(req0, 3, exp0, 3, "step 0");
  }
}

/* ReadDTCInformation with unsupported subfunction
 * category=negative template=None requirements=REQ-014 origin=gold
 */
testcase TC_gold_dtc_read_bad_sub()
{
  testCaseTitle("gold_dtc_read_bad_sub", "ReadDTCInformation with unsupported subfunction");
  // step 0: send request
  {
    byte req0[3] = {0x19, 0x01, 0xFF};
    byte exp0[3] = {0x7F, 0x19, 0x12};
    SendAndCheck(req0, 3, exp0, 3, "step 0");
  }
}

/* Inject a DTC status and read it back with a mask
 * category=positive template=None requirements=- origin=gold
 */
testcase TC_gold_dtc_set_and_read()
{
  testCaseTitle("gold_dtc_set_and_read", "Inject a DTC status and read it back with a mask");
  // step 0: TODO provoke DTC B10101 with status 0x08 (simulator-only fault injection)
  // step 1: send request
  {
    byte req1[3] = {0x19, 0x02, 0x08};
    byte exp1[7] = {0x59, 0x02, 0xFF, 0xB1, 0x01, 0x01, 0x08};
    SendAndCheck(req1, 3, exp1, 7, "step 1");
  }
}

/* Clear all DTCs
 * category=positive template=None requirements=- origin=gold
 */
testcase TC_gold_dtc_clear_all()
{
  testCaseTitle("gold_dtc_clear_all", "Clear all DTCs");
  // step 0: TODO provoke DTC B10101 with status 0x08 (simulator-only fault injection)
  // step 1: send request
  {
    byte req1[3] = {0x19, 0x02, 0x08};
    byte exp1[7] = {0x59, 0x02, 0xFF, 0xB1, 0x01, 0x01, 0x08};
    SendAndCheck(req1, 3, exp1, 7, "step 1");
  }
  // step 2: send request
  {
    byte req2[4] = {0x14, 0xFF, 0xFF, 0xFF};
    byte exp2[1] = {0x54};
    SendAndCheck(req2, 4, exp2, 1, "step 2");
  }
  // step 3: send request
  {
    byte req3[3] = {0x19, 0x02, 0x08};
    byte exp3[3] = {0x59, 0x02, 0xFF};
    SendAndCheck(req3, 3, exp3, 3, "step 3");
  }
}

/* Clear one specific DTC, others untouched
 * category=positive template=None requirements=- origin=gold
 */
testcase TC_gold_dtc_clear_specific()
{
  testCaseTitle("gold_dtc_clear_specific", "Clear one specific DTC, others untouched");
  // step 0: TODO provoke DTC B10101 with status 0x08 (simulator-only fault injection)
  // step 1: TODO provoke DTC B10205 with status 0x08 (simulator-only fault injection)
  // step 2: send request
  {
    byte req2[4] = {0x14, 0xB1, 0x01, 0x01};
    byte exp2[1] = {0x54};
    SendAndCheck(req2, 4, exp2, 1, "step 2");
  }
  // step 3: send request
  {
    byte req3[3] = {0x19, 0x02, 0x08};
    byte exp3[7] = {0x59, 0x02, 0xFF, 0xB1, 0x02, 0x05, 0x08};
    SendAndCheck(req3, 3, exp3, 7, "step 3");
  }
}

/* Clear with an unknown DTC group
 * category=negative template=None requirements=- origin=gold
 */
testcase TC_gold_dtc_clear_unknown_group()
{
  testCaseTitle("gold_dtc_clear_unknown_group", "Clear with an unknown DTC group");
  // step 0: send request
  {
    byte req0[4] = {0x14, 0x12, 0x34, 0x56};
    byte exp0[3] = {0x7F, 0x14, 0x31};
    SendAndCheck(req0, 4, exp0, 3, "step 0");
  }
}

/* Clear DTCs while NVM write fault is active
 * category=negative template=None requirements=- origin=gold
 */
testcase TC_gold_dtc_clear_nvm_fault()
{
  testCaseTitle("gold_dtc_clear_nvm_fault", "Clear DTCs while NVM write fault is active");
  // step 0: TODO set environment on the bench: vehicle_speed_kph=None nvm_write_fault=True
  // step 1: send request
  {
    byte req1[4] = {0x14, 0xFF, 0xFF, 0xFF};
    byte exp1[3] = {0x7F, 0x14, 0x72};
    SendAndCheck(req1, 4, exp1, 3, "step 1");
  }
}

/* Write a DID while NVM write fault is active
 * category=negative template=None requirements=- origin=gold
 */
testcase TC_gold_write_nvm_fault()
{
  testCaseTitle("gold_write_nvm_fault", "Write a DID while NVM write fault is active");
  // step 0: send request
  {
    byte req0[2] = {0x10, 0x03};
    byte exp0[6] = {0x50, 0x03, 0x00, 0x32, 0x01, 0xF4};
    SendAndCheck(req0, 2, exp0, 6, "step 0");
  }
  // step 1: send request
  {
    byte req1[2] = {0x27, 0x01};
    byte exp1[6] = {0x67, 0x01, 0x95, 0x06, 0x77, 0xE8};
    SendAndCheck(req1, 2, exp1, 6, "step 1");
  }
  // step 2: send request
  {
    byte req2[6] = {0x27, 0x02, 0x9A, 0x06, 0x8F, 0x73};
    byte exp2[2] = {0x67, 0x02};
    SendAndCheck(req2, 6, exp2, 2, "step 2");
  }
  // step 3: TODO set environment on the bench: vehicle_speed_kph=None nvm_write_fault=True
  // step 4: send request
  {
    byte req4[4] = {0x2E, 0x01, 0x00, 0x14};
    byte exp4[3] = {0x7F, 0x2E, 0x72};
    SendAndCheck(req4, 4, exp4, 3, "step 4");
  }
}

/* TesterPresent keeps the S3 timer alive
 * category=positive template=None requirements=REQ-015 origin=gold
 */
testcase TC_gold_tester_present()
{
  testCaseTitle("gold_tester_present", "TesterPresent keeps the S3 timer alive");
  // step 0: send request
  {
    byte req0[2] = {0x3E, 0x00};
    byte exp0[2] = {0x7E, 0x00};
    SendAndCheck(req0, 2, exp0, 2, "step 0");
  }
}

/* TesterPresent with suppress bit set
 * category=positive template=None requirements=- origin=gold
 */
testcase TC_gold_tester_present_suppressed()
{
  testCaseTitle("gold_tester_present_suppressed", "TesterPresent with suppress bit set");
  // step 0: send request
  {
    byte req0[2] = {0x3E, 0x80};
    SendAndCheck(req0, 2, req0, 0, "step 0");
  }
}

/* Negative responses are never suppressed
 * category=negative template=None requirements=- origin=gold
 */
testcase TC_gold_tester_present_bad_sub_not_suppressed()
{
  testCaseTitle("gold_tester_present_bad_sub_not_suppressed", "Negative responses are never suppressed");
  // step 0: send request
  {
    byte req0[2] = {0x3E, 0x81};
    byte exp0[3] = {0x7F, 0x3E, 0x12};
    SendAndCheck(req0, 2, exp0, 3, "step 0");
  }
}

/* S3 timeout reverts session before next request
 * category=timing template=None requirements=- origin=gold
 */
testcase TC_gold_s3_timeout_reverts()
{
  testCaseTitle("gold_s3_timeout_reverts", "S3 timeout reverts session before next request");
  // step 0: send request
  {
    byte req0[2] = {0x10, 0x03};
    byte exp0[6] = {0x50, 0x03, 0x00, 0x32, 0x01, 0xF4};
    SendAndCheck(req0, 2, exp0, 6, "step 0");
  }
  // step 1: Idle past s3_ms (5000).
  testWaitForTimeout(5001);
  // step 2: send request
  {
    byte req2[3] = {0x22, 0xF1, 0x86};
    byte exp2[4] = {0x62, 0xF1, 0x86, 0x01};
    SendAndCheck(req2, 3, exp2, 4, "step 2");
  }
}

/* Exactly s3_ms idle does not expire the session
 * category=timing template=None requirements=- origin=gold
 */
testcase TC_gold_s3_no_timeout_at_exactly_s3ms()
{
  testCaseTitle("gold_s3_no_timeout_at_exactly_s3ms", "Exactly s3_ms idle does not expire the session");
  // step 0: send request
  {
    byte req0[2] = {0x10, 0x03};
    byte exp0[6] = {0x50, 0x03, 0x00, 0x32, 0x01, 0xF4};
    SendAndCheck(req0, 2, exp0, 6, "step 0");
  }
  // step 1: Idle exactly s3_ms.
  testWaitForTimeout(5000);
  // step 2: send request
  {
    byte req2[3] = {0x22, 0xF1, 0x86};
    byte exp2[4] = {0x62, 0xF1, 0x86, 0x03};
    SendAndCheck(req2, 3, exp2, 4, "step 2");
  }
}

/* Suppressed ECU reset still changes state
 * category=positive template=None requirements=- origin=gold
 */
testcase TC_gold_ecu_reset_suppressed()
{
  testCaseTitle("gold_ecu_reset_suppressed", "Suppressed ECU reset still changes state");
  // step 0: send request
  {
    byte req0[2] = {0x10, 0x03};
    byte exp0[6] = {0x50, 0x03, 0x00, 0x32, 0x01, 0xF4};
    SendAndCheck(req0, 2, exp0, 6, "step 0");
  }
  // step 1: send request
  {
    byte req1[2] = {0x11, 0x81};
    SendAndCheck(req1, 2, req1, 0, "step 1");
  }
  // step 2: send request
  {
    byte req2[3] = {0x22, 0xF1, 0x86};
    byte exp2[4] = {0x62, 0xF1, 0x86, 0x01};
    SendAndCheck(req2, 3, exp2, 4, "step 2");
  }
}

/* Multi-DID read where one DID is unknown fails the whole request
 * category=negative template=None requirements=REQ-002 origin=gold
 */
testcase TC_gold_multi_did_read_one_bad()
{
  testCaseTitle("gold_multi_did_read_one_bad", "Multi-DID read where one DID is unknown fails the whole request");
  // step 0: send request
  {
    byte req0[5] = {0x22, 0xF1, 0x90, 0x99, 0x99};
    byte exp0[3] = {0x7F, 0x22, 0x31};
    SendAndCheck(req0, 5, exp0, 3, "step 0");
  }
}

/* Duplicate DIDs are allowed in one read request
 * category=positive template=None requirements=- origin=gold
 */
testcase TC_gold_duplicate_did_read()
{
  testCaseTitle("gold_duplicate_did_read", "Duplicate DIDs are allowed in one read request");
  // step 0: send request
  {
    byte req0[5] = {0x22, 0x01, 0x40, 0x01, 0x40};
    byte exp0[7] = {0x62, 0x01, 0x40, 0x00, 0x01, 0x40, 0x00};
    SendAndCheck(req0, 5, exp0, 7, "step 0");
  }
}

/* Requesting a new seed while already unlocked
 * category=security template=None requirements=- origin=gold
 */
testcase TC_gold_security_already_unlocked_seed()
{
  testCaseTitle("gold_security_already_unlocked_seed", "Requesting a new seed while already unlocked");
  // step 0: send request
  {
    byte req0[2] = {0x10, 0x03};
    byte exp0[6] = {0x50, 0x03, 0x00, 0x32, 0x01, 0xF4};
    SendAndCheck(req0, 2, exp0, 6, "step 0");
  }
  // step 1: send request
  {
    byte req1[2] = {0x27, 0x01};
    byte exp1[6] = {0x67, 0x01, 0x95, 0x06, 0x77, 0xE8};
    SendAndCheck(req1, 2, exp1, 6, "step 1");
  }
  // step 2: send request
  {
    byte req2[6] = {0x27, 0x02, 0x9A, 0x06, 0x8F, 0x73};
    byte exp2[2] = {0x67, 0x02};
    SendAndCheck(req2, 6, exp2, 2, "step 2");
  }
  // step 3: send request
  {
    byte req3[2] = {0x27, 0x01};
    byte exp3[6] = {0x67, 0x01, 0x00, 0x00, 0x00, 0x00};
    SendAndCheck(req3, 2, exp3, 6, "step 3");
  }
}

/* Live vehicle speed DID reflects environment
 * category=positive template=None requirements=- origin=gold
 */
testcase TC_gold_read_vehicle_speed_live()
{
  testCaseTitle("gold_read_vehicle_speed_live", "Live vehicle speed DID reflects environment");
  // step 0: TODO set environment on the bench: vehicle_speed_kph=42 nvm_write_fault=None
  // step 1: send request
  {
    byte req1[3] = {0x22, 0x01, 0x40};
    byte exp1[4] = {0x62, 0x01, 0x40, 0x2A};
    SendAndCheck(req1, 3, exp1, 4, "step 1");
  }
}

/* Live active-session DID reflects the current session
 * category=positive template=None requirements=- origin=gold
 */
testcase TC_gold_read_active_session_live()
{
  testCaseTitle("gold_read_active_session_live", "Live active-session DID reflects the current session");
  // step 0: send request
  {
    byte req0[2] = {0x10, 0x02};
    byte exp0[6] = {0x50, 0x02, 0x00, 0x32, 0x01, 0xF4};
    SendAndCheck(req0, 2, exp0, 6, "step 0");
  }
  // step 1: send request
  {
    byte req1[3] = {0x22, 0xF1, 0x86};
    byte exp1[4] = {0x62, 0xF1, 0x86, 0x02};
    SendAndCheck(req1, 3, exp1, 4, "step 1");
  }
}

/* Unlock level 3 in programming session, write 2-byte coding variant
 * category=positive template=None requirements=- origin=gold
 */
testcase TC_gold_write_coding_variant()
{
  testCaseTitle("gold_write_coding_variant", "Unlock level 3 in programming session, write 2-byte coding variant");
  // step 0: send request
  {
    byte req0[2] = {0x10, 0x02};
    byte exp0[6] = {0x50, 0x02, 0x00, 0x32, 0x01, 0xF4};
    SendAndCheck(req0, 2, exp0, 6, "step 0");
  }
  // step 1: send request
  {
    byte req1[2] = {0x27, 0x03};
    byte exp1[6] = {0x67, 0x03, 0x0B, 0x7C, 0xED, 0x5E};
    SendAndCheck(req1, 2, exp1, 6, "step 1");
  }
  // step 2: send request
  {
    byte req2[6] = {0x27, 0x04, 0x20, 0xA9, 0x2D, 0xBA};
    byte exp2[2] = {0x67, 0x04};
    SendAndCheck(req2, 6, exp2, 2, "step 2");
  }
  // step 3: send request
  {
    byte req3[5] = {0x2E, 0x01, 0x60, 0x00, 0x05};
    byte exp3[3] = {0x6E, 0x01, 0x60};
    SendAndCheck(req3, 5, exp3, 3, "step 3");
  }
  // step 4: send request
  {
    byte req4[3] = {0x22, 0x01, 0x60};
    byte exp4[5] = {0x62, 0x01, 0x60, 0x00, 0x05};
    SendAndCheck(req4, 3, exp4, 5, "step 4");
  }
}

/* Write factory reset flag while stationary
 * category=positive template=None requirements=REQ-009 origin=gold
 */
testcase TC_gold_write_factory_reset_flag_positive()
{
  testCaseTitle("gold_write_factory_reset_flag_positive", "Write factory reset flag while stationary");
  // step 0: send request
  {
    byte req0[2] = {0x10, 0x02};
    byte exp0[6] = {0x50, 0x02, 0x00, 0x32, 0x01, 0xF4};
    SendAndCheck(req0, 2, exp0, 6, "step 0");
  }
  // step 1: send request
  {
    byte req1[2] = {0x27, 0x03};
    byte exp1[6] = {0x67, 0x03, 0x0B, 0x7C, 0xED, 0x5E};
    SendAndCheck(req1, 2, exp1, 6, "step 1");
  }
  // step 2: send request
  {
    byte req2[6] = {0x27, 0x04, 0x20, 0xA9, 0x2D, 0xBA};
    byte exp2[2] = {0x67, 0x04};
    SendAndCheck(req2, 6, exp2, 2, "step 2");
  }
  // step 3: send request
  {
    byte req3[4] = {0x2E, 0x01, 0x50, 0x01};
    byte exp3[3] = {0x6E, 0x01, 0x50};
    SendAndCheck(req3, 4, exp3, 3, "step 3");
  }
}

/* Write factory reset flag while moving
 * category=negative template=None requirements=REQ-009 origin=gold
 */
testcase TC_gold_write_factory_reset_flag_moving()
{
  testCaseTitle("gold_write_factory_reset_flag_moving", "Write factory reset flag while moving");
  // step 0: send request
  {
    byte req0[2] = {0x10, 0x02};
    byte exp0[6] = {0x50, 0x02, 0x00, 0x32, 0x01, 0xF4};
    SendAndCheck(req0, 2, exp0, 6, "step 0");
  }
  // step 1: send request
  {
    byte req1[2] = {0x27, 0x03};
    byte exp1[6] = {0x67, 0x03, 0x0B, 0x7C, 0xED, 0x5E};
    SendAndCheck(req1, 2, exp1, 6, "step 1");
  }
  // step 2: send request
  {
    byte req2[6] = {0x27, 0x04, 0x20, 0xA9, 0x2D, 0xBA};
    byte exp2[2] = {0x67, 0x04};
    SendAndCheck(req2, 6, exp2, 2, "step 2");
  }
  // step 3: TODO set environment on the bench: vehicle_speed_kph=5 nvm_write_fault=None
  // step 4: send request
  {
    byte req4[4] = {0x2E, 0x01, 0x50, 0x01};
    byte exp4[3] = {0x7F, 0x2E, 0x22};
    SendAndCheck(req4, 4, exp4, 3, "step 4");
  }
}

/* Correct key for the wrong level does not unlock it
 * category=security template=None requirements=- origin=gold
 */
testcase TC_gold_security_wrong_level_unlock()
{
  testCaseTitle("gold_security_wrong_level_unlock", "Correct key for the wrong level does not unlock it");
  // step 0: send request
  {
    byte req0[2] = {0x10, 0x03};
    byte exp0[6] = {0x50, 0x03, 0x00, 0x32, 0x01, 0xF4};
    SendAndCheck(req0, 2, exp0, 6, "step 0");
  }
  // step 1: send request
  {
    byte req1[2] = {0x27, 0x01};
    byte exp1[6] = {0x67, 0x01, 0x95, 0x06, 0x77, 0xE8};
    SendAndCheck(req1, 2, exp1, 6, "step 1");
  }
  // step 2: send request
  {
    byte req2[6] = {0x27, 0x02, 0x00, 0x00, 0x00, 0x01};
    byte exp2[3] = {0x7F, 0x27, 0x35};
    SendAndCheck(req2, 6, exp2, 3, "step 2");
  }
}

/* Unknown DID write in a session where 0x2E isn't allowed
 * category=session template=None requirements=- origin=gold
 */
testcase TC_gold_write_unknown_did_default_session()
{
  testCaseTitle("gold_write_unknown_did_default_session", "Unknown DID write in a session where 0x2E isn't allowed");
  // step 0: send request
  {
    byte req0[4] = {0x2E, 0x99, 0x99, 0x00};
    byte exp0[3] = {0x7F, 0x2E, 0x7F};
    SendAndCheck(req0, 4, exp0, 3, "step 0");
  }
}

/* Security is re-locked by any positive 0x10, even same session
 * category=security template=None requirements=- origin=gold
 */
testcase TC_gold_security_relocked_on_session_reentry()
{
  testCaseTitle("gold_security_relocked_on_session_reentry", "Security is re-locked by any positive 0x10, even same session");
  // step 0: send request
  {
    byte req0[2] = {0x10, 0x03};
    byte exp0[6] = {0x50, 0x03, 0x00, 0x32, 0x01, 0xF4};
    SendAndCheck(req0, 2, exp0, 6, "step 0");
  }
  // step 1: send request
  {
    byte req1[2] = {0x27, 0x01};
    byte exp1[6] = {0x67, 0x01, 0x95, 0x06, 0x77, 0xE8};
    SendAndCheck(req1, 2, exp1, 6, "step 1");
  }
  // step 2: send request
  {
    byte req2[6] = {0x27, 0x02, 0x9A, 0x06, 0x8F, 0x73};
    byte exp2[2] = {0x67, 0x02};
    SendAndCheck(req2, 6, exp2, 2, "step 2");
  }
  // step 3: send request
  {
    byte req3[4] = {0x2E, 0x01, 0x00, 0x14};
    byte exp3[3] = {0x6E, 0x01, 0x00};
    SendAndCheck(req3, 4, exp3, 3, "step 3");
  }
  // step 4: send request
  {
    byte req4[2] = {0x10, 0x03};
    byte exp4[6] = {0x50, 0x03, 0x00, 0x32, 0x01, 0xF4};
    SendAndCheck(req4, 2, exp4, 6, "step 4");
  }
  // step 5: send request
  {
    byte req5[4] = {0x2E, 0x01, 0x00, 0x14};
    byte exp5[3] = {0x7F, 0x2E, 0x33};
    SendAndCheck(req5, 4, exp5, 3, "step 5");
  }
}


/* Test module entry point: runs every exported test case. */
void MainTest()
{
  TC_gold_dtc_clear_all();
  TC_gold_dtc_clear_nvm_fault();
  TC_gold_dtc_clear_specific();
  TC_gold_dtc_clear_unknown_group();
  TC_gold_dtc_read_bad_sub();
  TC_gold_dtc_read_default();
  TC_gold_dtc_set_and_read();
  TC_gold_duplicate_did_read();
  TC_gold_ecu_reset_bad_sub();
  TC_gold_ecu_reset_hard();
  TC_gold_ecu_reset_soft();
  TC_gold_ecu_reset_suppressed();
  TC_gold_multi_did_read_one_bad();
  TC_gold_read_active_session_live();
  TC_gold_read_partnum_serial_multi();
  TC_gold_read_unknown_did();
  TC_gold_read_vehicle_speed_live();
  TC_gold_read_vin_default();
  TC_gold_read_vin_extended();
  TC_gold_routine_door_cal_condition_fail();
  TC_gold_routine_door_cal_positive();
  TC_gold_routine_lighting_full_sequence();
  TC_gold_routine_nvm_restore_long_running();
  TC_gold_routine_nvm_restore_wrong_session();
  TC_gold_routine_results_before_start();
  TC_gold_routine_start_without_security();
  TC_gold_routine_stop_before_start();
  TC_gold_s3_no_timeout_at_exactly_s3ms();
  TC_gold_s3_timeout_reverts();
  TC_gold_security_already_unlocked_seed();
  TC_gold_security_key_without_seed();
  TC_gold_security_level3_subfunction_wrong_session();
  TC_gold_security_lockout_after_3();
  TC_gold_security_not_allowed_default_session();
  TC_gold_security_relocked_on_session_reentry();
  TC_gold_security_seed_level1();
  TC_gold_security_wrong_key_once();
  TC_gold_security_wrong_level_unlock();
  TC_gold_session_back_default();
  TC_gold_session_programming();
  TC_gold_session_to_extended();
  TC_gold_session_unsupported_sub();
  TC_gold_session_wrong_length();
  TC_gold_tester_present();
  TC_gold_tester_present_bad_sub_not_suppressed();
  TC_gold_tester_present_suppressed();
  TC_gold_unsupported_sid();
  TC_gold_write_coding_variant();
  TC_gold_write_factory_reset_flag_moving();
  TC_gold_write_factory_reset_flag_positive();
  TC_gold_write_nvm_fault();
  TC_gold_write_out_of_range_brightness();
  TC_gold_write_out_of_range_wiper();
  TC_gold_write_readonly_did();
  TC_gold_write_secured_positive_ambient_color();
  TC_gold_write_secured_positive_lighting();
  TC_gold_write_unknown_did();
  TC_gold_write_unknown_did_default_session();
  TC_gold_write_without_unlock();
  TC_gold_write_wrong_length();
}
