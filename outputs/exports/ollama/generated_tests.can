/*
 * UNVERIFIED TEMPLATE — not compiled or run in CANoe
 *
 * Generated by uds_assistant.export.to_capl from 68 test case(s).
 * Request/response bytes are copied verbatim from the test cases (templates +
 * rules-engine oracle, or the hand-written gold set). The ECU spec is SYNTHETIC.
 * Adapt the diagnostic target / CDD binding before use; review every test.
 */

includes
{
}

variables
{
  const dword kP2TimeoutMs = 2000;      // generous tester-side timeout per request
  const dword kSilenceWaitMs = 300;     // wait used when no response is expected
}

/* Send raw request bytes and compare the final response with the expected bytes.
 * expectedLen == 0 means "no response expected" (suppressed positive response). */
int SendAndCheck(byte req[], dword reqLen, byte expected[], dword expectedLen, char stepName[])
{
  diagRequest * rawReq;
  diagResponse * rawResp;
  dword i;
  long waitResult;
  byte actual[4095];
  long actualLen;

  diagResize(rawReq, reqLen);
  for (i = 0; i < reqLen; i++)
    diagSetPrimitiveByte(rawReq, i, req[i]);
  diagSendRequest(rawReq);

  if (expectedLen == 0)
  {
    waitResult = testWaitForDiagResponse(rawReq, kSilenceWaitMs);
    if (waitResult == 1)
    {
      testStepFail(stepName, "Unexpected response (positive response should be suppressed)");
      return 0;
    }
    testStepPass(stepName, "No response, as expected");
    return 1;
  }

  waitResult = testWaitForDiagResponse(rawReq, kP2TimeoutMs);
  if (waitResult != 1)
  {
    testStepFail(stepName, "No response within timeout");
    return 0;
  }
  diagGetLastResponse(rawReq, rawResp);
  actualLen = diagGetPrimitiveSize(rawResp);
  if (actualLen != expectedLen)
  {
    testStepFail(stepName, "Response length %d, expected %d", actualLen, expectedLen);
    return 0;
  }
  for (i = 0; i < expectedLen; i++)
  {
    actual[i] = diagGetPrimitiveByte(rawResp, i);
    if (actual[i] != expected[i])
    {
      testStepFail(stepName, "Byte %d is 0x%02X, expected 0x%02X", i, actual[i], expected[i]);
      return 0;
    }
  }
  testStepPass(stepName, "Response matches");
  return 1;
}


/* Read DID VIN (0xf190) positively in session 0x1
 * category=positive template=read_did_positive requirements=REQ-001 origin=generated
 */
testcase TC_req_001__tpl_read_did_positive_f190_01()
{
  testCaseTitle("req_001__tpl_read_did_positive_f190_01", "Read DID VIN (0xf190) positively in session 0x1");
  // step 0: Read DID 0xf190 (VIN) in session 0x1.
  {
    byte req0[3] = {0x22, 0xF1, 0x90};
    byte exp0[20] = {0x62, 0xF1, 0x90, 0x53, 0x59, 0x4E, 0x54, 0x48, 0x45, 0x54, 0x49, 0x43, 0x42, 0x4D, 0x30, 0x30, 0x30, 0x30, 0x30, 0x31};
    SendAndCheck(req0, 3, exp0, 20, "step 0");
  }
}

/* Read DID VIN (0xf190) positively in session 0x2
 * category=positive template=read_did_positive requirements=REQ-001 origin=generated
 */
testcase TC_req_001__tpl_read_did_positive_f190_02()
{
  testCaseTitle("req_001__tpl_read_did_positive_f190_02", "Read DID VIN (0xf190) positively in session 0x2");
  // step 0: Switch to session 0x2.
  {
    byte req0[2] = {0x10, 0x02};
    byte exp0[6] = {0x50, 0x02, 0x00, 0x32, 0x01, 0xF4};
    SendAndCheck(req0, 2, exp0, 6, "step 0");
  }
  // step 1: Read DID 0xf190 (VIN) in session 0x2.
  {
    byte req1[3] = {0x22, 0xF1, 0x90};
    byte exp1[20] = {0x62, 0xF1, 0x90, 0x53, 0x59, 0x4E, 0x54, 0x48, 0x45, 0x54, 0x49, 0x43, 0x42, 0x4D, 0x30, 0x30, 0x30, 0x30, 0x30, 0x31};
    SendAndCheck(req1, 3, exp1, 20, "step 1");
  }
}

/* Read DID VIN (0xf190) positively in session 0x3
 * category=positive template=read_did_positive requirements=REQ-001 origin=generated
 */
testcase TC_req_001__tpl_read_did_positive_f190_03()
{
  testCaseTitle("req_001__tpl_read_did_positive_f190_03", "Read DID VIN (0xf190) positively in session 0x3");
  // step 0: Switch to session 0x3.
  {
    byte req0[2] = {0x10, 0x03};
    byte exp0[6] = {0x50, 0x03, 0x00, 0x32, 0x01, 0xF4};
    SendAndCheck(req0, 2, exp0, 6, "step 0");
  }
  // step 1: Read DID 0xf190 (VIN) in session 0x3.
  {
    byte req1[3] = {0x22, 0xF1, 0x90};
    byte exp1[20] = {0x62, 0xF1, 0x90, 0x53, 0x59, 0x4E, 0x54, 0x48, 0x45, 0x54, 0x49, 0x43, 0x42, 0x4D, 0x30, 0x30, 0x30, 0x30, 0x30, 0x31};
    SendAndCheck(req1, 3, exp1, 20, "step 1");
  }
}

/* Multi-DID read manufacturer_part_number + VIN in session 0x1
 * category=positive template=read_multiple_dids requirements=REQ-002 origin=generated
 */
testcase TC_req_002__tpl_read_multi_f187_f190_01()
{
  testCaseTitle("req_002__tpl_read_multi_f187_f190_01", "Multi-DID read manufacturer_part_number + VIN in session 0x1");
  // step 0: Read DIDs 0xf187, 0xf190 in one request -> every record, in order.
  {
    byte req0[5] = {0x22, 0xF1, 0x87, 0xF1, 0x90};
    byte exp0[32] = {0x62, 0xF1, 0x87, 0x42, 0x43, 0x4D, 0x2D, 0x31, 0x32, 0x33, 0x34, 0x35, 0x2D, 0xF1, 0x90, 0x53, 0x59, 0x4E, 0x54, 0x48, 0x45, 0x54, 0x49, 0x43, 0x42, 0x4D, 0x30, 0x30, 0x30, 0x30, 0x30, 0x31};
    SendAndCheck(req0, 5, exp0, 32, "step 0");
  }
}

/* Read DID manufacturer_part_number (0xf187) positively in session 0x1
 * category=positive template=read_did_positive requirements=REQ-002 origin=generated
 */
testcase TC_req_002__tpl_read_did_positive_f187_01()
{
  testCaseTitle("req_002__tpl_read_did_positive_f187_01", "Read DID manufacturer_part_number (0xf187) positively in session 0x1");
  // step 0: Read DID 0xf187 (manufacturer_part_number) in session 0x1.
  {
    byte req0[3] = {0x22, 0xF1, 0x87};
    byte exp0[13] = {0x62, 0xF1, 0x87, 0x42, 0x43, 0x4D, 0x2D, 0x31, 0x32, 0x33, 0x34, 0x35, 0x2D};
    SendAndCheck(req0, 3, exp0, 13, "step 0");
  }
}

/* Read DID ecu_serial_number (0xf18c) positively in session 0x1
 * category=positive template=read_did_positive requirements=REQ-002 origin=generated
 */
testcase TC_req_002__tpl_read_did_positive_f18c_01()
{
  testCaseTitle("req_002__tpl_read_did_positive_f18c_01", "Read DID ecu_serial_number (0xf18c) positively in session 0x1");
  // step 0: Read DID 0xf18c (ecu_serial_number) in session 0x1.
  {
    byte req0[3] = {0x22, 0xF1, 0x8C};
    byte exp0[11] = {0x62, 0xF1, 0x8C, 0x53, 0x45, 0x30, 0x30, 0x30, 0x30, 0x30, 0x31};
    SendAndCheck(req0, 3, exp0, 11, "step 0");
  }
}

/* Read DID manufacturer_part_number (0xf187) positively in session 0x2
 * category=positive template=read_did_positive requirements=REQ-002 origin=generated
 */
testcase TC_req_002__tpl_read_did_positive_f187_02()
{
  testCaseTitle("req_002__tpl_read_did_positive_f187_02", "Read DID manufacturer_part_number (0xf187) positively in session 0x2");
  // step 0: Switch to session 0x2.
  {
    byte req0[2] = {0x10, 0x02};
    byte exp0[6] = {0x50, 0x02, 0x00, 0x32, 0x01, 0xF4};
    SendAndCheck(req0, 2, exp0, 6, "step 0");
  }
  // step 1: Read DID 0xf187 (manufacturer_part_number) in session 0x2.
  {
    byte req1[3] = {0x22, 0xF1, 0x87};
    byte exp1[13] = {0x62, 0xF1, 0x87, 0x42, 0x43, 0x4D, 0x2D, 0x31, 0x32, 0x33, 0x34, 0x35, 0x2D};
    SendAndCheck(req1, 3, exp1, 13, "step 1");
  }
}

/* Read DID manufacturer_part_number (0xf187) positively in session 0x3
 * category=positive template=read_did_positive requirements=REQ-002 origin=generated
 */
testcase TC_req_002__tpl_read_did_positive_f187_03()
{
  testCaseTitle("req_002__tpl_read_did_positive_f187_03", "Read DID manufacturer_part_number (0xf187) positively in session 0x3");
  // step 0: Switch to session 0x3.
  {
    byte req0[2] = {0x10, 0x03};
    byte exp0[6] = {0x50, 0x03, 0x00, 0x32, 0x01, 0xF4};
    SendAndCheck(req0, 2, exp0, 6, "step 0");
  }
  // step 1: Read DID 0xf187 (manufacturer_part_number) in session 0x3.
  {
    byte req1[3] = {0x22, 0xF1, 0x87};
    byte exp1[13] = {0x62, 0xF1, 0x87, 0x42, 0x43, 0x4D, 0x2D, 0x31, 0x32, 0x33, 0x34, 0x35, 0x2D};
    SendAndCheck(req1, 3, exp1, 13, "step 1");
  }
}

/* Read DID active_diagnostic_session (0xf186) positively in session 0x1
 * category=positive template=read_did_positive requirements=REQ-003 origin=generated
 */
testcase TC_req_003__tpl_read_did_positive_f186_01()
{
  testCaseTitle("req_003__tpl_read_did_positive_f186_01", "Read DID active_diagnostic_session (0xf186) positively in session 0x1");
  // step 0: Read DID 0xf186 (active_diagnostic_session) in session 0x1.
  {
    byte req0[3] = {0x22, 0xF1, 0x86};
    byte exp0[4] = {0x62, 0xF1, 0x86, 0x01};
    SendAndCheck(req0, 3, exp0, 4, "step 0");
  }
}

/* Session change re-locks security level 0x1
 * category=security template=session_change_relocks_security requirements=REQ-003 origin=generated
 */
testcase TC_req_003__tpl_session_relock_01()
{
  testCaseTitle("req_003__tpl_session_relock_01", "Session change re-locks security level 0x1");
  // step 0: Switch to session 0x3.
  {
    byte req0[2] = {0x10, 0x03};
    byte exp0[6] = {0x50, 0x03, 0x00, 0x32, 0x01, 0xF4};
    SendAndCheck(req0, 2, exp0, 6, "step 0");
  }
  // step 1: Request seed for level 0x1.
  {
    byte req1[2] = {0x27, 0x01};
    byte exp1[6] = {0x67, 0x01, 0x95, 0x06, 0x77, 0xE8};
    SendAndCheck(req1, 2, exp1, 6, "step 1");
  }
  // step 2: Send computed key for level 0x1.
  {
    byte req2[6] = {0x27, 0x02, 0x9A, 0x06, 0x8F, 0x73};
    byte exp2[2] = {0x67, 0x02};
    SendAndCheck(req2, 6, exp2, 2, "step 2");
  }
  // step 3: Re-enter the same session -> security must be locked again.
  {
    byte req3[2] = {0x10, 0x03};
    byte exp3[6] = {0x50, 0x03, 0x00, 0x32, 0x01, 0xF4};
    SendAndCheck(req3, 2, exp3, 6, "step 3");
  }
  // step 4: Secured write to 0x0100 after re-entry -> expect NRC 0x33.
  {
    byte req4[4] = {0x2E, 0x01, 0x00, 0x00};
    byte exp4[3] = {0x7F, 0x2E, 0x33};
    SendAndCheck(req4, 4, exp4, 3, "step 4");
  }
  // step 5: Request seed -> a fresh non-zero seed (level is locked again).
  {
    byte req5[2] = {0x27, 0x01};
    byte exp5[6] = {0x67, 0x01, 0x32, 0xA3, 0x14, 0x85};
    SendAndCheck(req5, 2, exp5, 6, "step 5");
  }
}

/* S3 timeout drops session 0x3 back to default
 * category=timing template=s3_timeout_reverts_session requirements=REQ-003 origin=generated
 */
testcase TC_req_003__tpl_s3_timeout_03()
{
  testCaseTitle("req_003__tpl_s3_timeout_03", "S3 timeout drops session 0x3 back to default");
  // step 0: Switch to session 0x3.
  {
    byte req0[2] = {0x10, 0x03};
    byte exp0[6] = {0x50, 0x03, 0x00, 0x32, 0x01, 0xF4};
    SendAndCheck(req0, 2, exp0, 6, "step 0");
  }
  // step 1: Advance past the S3 timer with no requests.
  testWaitForTimeout(5001);
  // step 2: Read active session DID -> expect it reports default session 0x01.
  {
    byte req2[3] = {0x22, 0xF1, 0x86};
    byte exp2[4] = {0x62, 0xF1, 0x86, 0x01};
    SendAndCheck(req2, 3, exp2, 4, "step 2");
  }
}

/* Suppress positive response for service 0x10 in session 0x1
 * category=positive template=suppress_positive_response requirements=REQ-003 origin=generated
 */
testcase TC_req_003__tpl_suppress_positive_10_01()
{
  testCaseTitle("req_003__tpl_suppress_positive_10_01", "Suppress positive response for service 0x10 in session 0x1");
  // step 0: Suppress-positive-response bit set -> expect no response frame.
  {
    byte req0[2] = {0x10, 0x81};
    SendAndCheck(req0, 2, req0, 0, "step 0");
  }
}

/* Write DID interior_lighting_brightness_pct (0x0100) without unlocking security
 * category=negative template=write_did_without_security requirements=REQ-004 origin=generated
 */
testcase TC_req_004__tpl_write_nosec_0100()
{
  testCaseTitle("req_004__tpl_write_nosec_0100", "Write DID interior_lighting_brightness_pct (0x0100) without unlocking security");
  // step 0: Switch to session 0x3.
  {
    byte req0[2] = {0x10, 0x03};
    byte exp0[6] = {0x50, 0x03, 0x00, 0x32, 0x01, 0xF4};
    SendAndCheck(req0, 2, exp0, 6, "step 0");
  }
  // step 1: Write without unlocking security -> expect NRC 0x33.
  {
    byte req1[4] = {0x2E, 0x01, 0x00, 0x00};
    byte exp1[3] = {0x7F, 0x2E, 0x33};
    SendAndCheck(req1, 4, exp1, 3, "step 1");
  }
}

/* Write out-of-range value to DID interior_lighting_brightness_pct (0x0100)
 * category=negative template=write_did_out_of_range requirements=REQ-004 origin=generated
 */
testcase TC_req_004__tpl_write_oor_0100()
{
  testCaseTitle("req_004__tpl_write_oor_0100", "Write out-of-range value to DID interior_lighting_brightness_pct (0x0100)");
  // step 0: Switch to session 0x3.
  {
    byte req0[2] = {0x10, 0x03};
    byte exp0[6] = {0x50, 0x03, 0x00, 0x32, 0x01, 0xF4};
    SendAndCheck(req0, 2, exp0, 6, "step 0");
  }
  // step 1: Request seed for level 0x1.
  {
    byte req1[2] = {0x27, 0x01};
    byte exp1[6] = {0x67, 0x01, 0x95, 0x06, 0x77, 0xE8};
    SendAndCheck(req1, 2, exp1, 6, "step 1");
  }
  // step 2: Send computed key for level 0x1.
  {
    byte req2[6] = {0x27, 0x02, 0x9A, 0x06, 0x8F, 0x73};
    byte exp2[2] = {0x67, 0x02};
    SendAndCheck(req2, 6, exp2, 2, "step 2");
  }
  // step 3: Write out-of-range value 101 -> expect NRC 0x31.
  {
    byte req3[4] = {0x2E, 0x01, 0x00, 0x65};
    byte exp3[3] = {0x7F, 0x2E, 0x31};
    SendAndCheck(req3, 4, exp3, 3, "step 3");
  }
}

/* Write DID factory_reset_flag while vehicle is moving
 * category=negative template=condition_not_met requirements=REQ-004 origin=generated
 */
testcase TC_req_004__tpl_condition_not_met_did_0150()
{
  testCaseTitle("req_004__tpl_condition_not_met_did_0150", "Write DID factory_reset_flag while vehicle is moving");
  // step 0: Switch to session 0x2.
  {
    byte req0[2] = {0x10, 0x02};
    byte exp0[6] = {0x50, 0x02, 0x00, 0x32, 0x01, 0xF4};
    SendAndCheck(req0, 2, exp0, 6, "step 0");
  }
  // step 1: TODO set environment on the bench: vehicle_speed_kph=10 nvm_write_fault=None
  // step 2: Request seed for level 0x3.
  {
    byte req2[2] = {0x27, 0x03};
    byte exp2[6] = {0x67, 0x03, 0x0B, 0x7C, 0xED, 0x5E};
    SendAndCheck(req2, 2, exp2, 6, "step 2");
  }
  // step 3: Send computed key for level 0x3.
  {
    byte req3[6] = {0x27, 0x04, 0x20, 0xA9, 0x2D, 0xBA};
    byte exp3[2] = {0x67, 0x04};
    SendAndCheck(req3, 6, exp3, 2, "step 3");
  }
  // step 4: Write while vehicle is moving -> expect NRC 0x22.
  {
    byte req4[4] = {0x2E, 0x01, 0x50, 0x00};
    byte exp4[3] = {0x7F, 0x2E, 0x22};
    SendAndCheck(req4, 4, exp4, 3, "step 4");
  }
}

/* Read DID VIN (0xf190) positively in session 0x1
 * category=positive template=read_did_positive requirements=REQ-004 origin=generated
 */
testcase TC_req_004__tpl_read_did_positive_f190_01()
{
  testCaseTitle("req_004__tpl_read_did_positive_f190_01", "Read DID VIN (0xf190) positively in session 0x1");
  // step 0: Read DID 0xf190 (VIN) in session 0x1.
  {
    byte req0[3] = {0x22, 0xF1, 0x90};
    byte exp0[20] = {0x62, 0xF1, 0x90, 0x53, 0x59, 0x4E, 0x54, 0x48, 0x45, 0x54, 0x49, 0x43, 0x42, 0x4D, 0x30, 0x30, 0x30, 0x30, 0x30, 0x31};
    SendAndCheck(req0, 3, exp0, 20, "step 0");
  }
}

/* Write DID interior_lighting_brightness_pct (0x0100) after unlocking level 0x1
 * category=positive template=write_did_secured_positive requirements=REQ-005 origin=generated
 */
testcase TC_req_005__tpl_write_secured_0100()
{
  testCaseTitle("req_005__tpl_write_secured_0100", "Write DID interior_lighting_brightness_pct (0x0100) after unlocking level 0x1");
  // step 0: Switch to session 0x3.
  {
    byte req0[2] = {0x10, 0x03};
    byte exp0[6] = {0x50, 0x03, 0x00, 0x32, 0x01, 0xF4};
    SendAndCheck(req0, 2, exp0, 6, "step 0");
  }
  // step 1: Request seed for level 0x1.
  {
    byte req1[2] = {0x27, 0x01};
    byte exp1[6] = {0x67, 0x01, 0x95, 0x06, 0x77, 0xE8};
    SendAndCheck(req1, 2, exp1, 6, "step 1");
  }
  // step 2: Send computed key for level 0x1.
  {
    byte req2[6] = {0x27, 0x02, 0x9A, 0x06, 0x8F, 0x73};
    byte exp2[2] = {0x67, 0x02};
    SendAndCheck(req2, 6, exp2, 2, "step 2");
  }
  // step 3: Write 0 to DID 0x0100.
  {
    byte req3[4] = {0x2E, 0x01, 0x00, 0x00};
    byte exp3[3] = {0x6E, 0x01, 0x00};
    SendAndCheck(req3, 4, exp3, 3, "step 3");
  }
  // step 4: Read back to confirm the write.
  {
    byte req4[3] = {0x22, 0x01, 0x00};
    byte exp4[4] = {0x62, 0x01, 0x00, 0x00};
    SendAndCheck(req4, 3, exp4, 4, "step 4");
  }
}

/* Read DID interior_lighting_brightness_pct (0x0100) positively in session 0x3
 * category=positive template=read_did_positive requirements=REQ-005 origin=generated
 */
testcase TC_req_005__tpl_read_did_positive_0100_03()
{
  testCaseTitle("req_005__tpl_read_did_positive_0100_03", "Read DID interior_lighting_brightness_pct (0x0100) positively in session 0x3");
  // step 0: Switch to session 0x3.
  {
    byte req0[2] = {0x10, 0x03};
    byte exp0[6] = {0x50, 0x03, 0x00, 0x32, 0x01, 0xF4};
    SendAndCheck(req0, 2, exp0, 6, "step 0");
  }
  // step 1: Read DID 0x0100 (interior_lighting_brightness_pct) in session 0x3.
  {
    byte req1[3] = {0x22, 0x01, 0x00};
    byte exp1[4] = {0x62, 0x01, 0x00, 0x32};
    SendAndCheck(req1, 3, exp1, 4, "step 1");
  }
}

/* SecurityAccess level 0x1 lockout after 3 wrong keys
 * category=security template=security_invalid_key_lockout requirements=REQ-005 origin=generated
 */
testcase TC_req_005__tpl_security_lockout_01()
{
  testCaseTitle("req_005__tpl_security_lockout_01", "SecurityAccess level 0x1 lockout after 3 wrong keys");
  // step 0: Switch to session 0x3.
  {
    byte req0[2] = {0x10, 0x03};
    byte exp0[6] = {0x50, 0x03, 0x00, 0x32, 0x01, 0xF4};
    SendAndCheck(req0, 2, exp0, 6, "step 0");
  }
  // step 1: Request seed, attempt 1.
  {
    byte req1[2] = {0x27, 0x01};
    byte exp1[6] = {0x67, 0x01, 0x95, 0x06, 0x77, 0xE8};
    SendAndCheck(req1, 2, exp1, 6, "step 1");
  }
  // step 2: Send wrong key, attempt 1.
  {
    byte req2[6] = {0x27, 0x02, 0x96, 0x07, 0x78, 0xE9};
    byte exp2[3] = {0x7F, 0x27, 0x35};
    SendAndCheck(req2, 6, exp2, 3, "step 2");
  }
  // step 3: Request seed, attempt 2.
  {
    byte req3[2] = {0x27, 0x01};
    byte exp3[6] = {0x67, 0x01, 0x32, 0xA3, 0x14, 0x85};
    SendAndCheck(req3, 2, exp3, 6, "step 3");
  }
  // step 4: Send wrong key, attempt 2.
  {
    byte req4[6] = {0x27, 0x02, 0x33, 0xA4, 0x15, 0x86};
    byte exp4[3] = {0x7F, 0x27, 0x35};
    SendAndCheck(req4, 6, exp4, 3, "step 4");
  }
  // step 5: Request seed, attempt 3.
  {
    byte req5[2] = {0x27, 0x01};
    byte exp5[6] = {0x67, 0x01, 0xCF, 0x40, 0xB1, 0x22};
    SendAndCheck(req5, 2, exp5, 6, "step 5");
  }
  // step 6: Send wrong key, attempt 3.
  {
    byte req6[6] = {0x27, 0x02, 0xD0, 0x41, 0xB2, 0x23};
    byte exp6[3] = {0x7F, 0x27, 0x36};
    SendAndCheck(req6, 6, exp6, 3, "step 6");
  }
  // step 7: Request seed during lockout -> expect NRC 0x37.
  {
    byte req7[2] = {0x27, 0x01};
    byte exp7[3] = {0x7F, 0x27, 0x37};
    SendAndCheck(req7, 2, exp7, 3, "step 7");
  }
  // step 8: Advance past the lockout delay.
  testWaitForTimeout(10001);
  // step 9: Re-enter the session (S3 expired during the wait).
  {
    byte req9[2] = {0x10, 0x03};
    byte exp9[6] = {0x50, 0x03, 0x00, 0x32, 0x01, 0xF4};
    SendAndCheck(req9, 2, exp9, 6, "step 9");
  }
  // step 10: Request seed after delay expiry -> seed issued again.
  {
    byte req10[2] = {0x27, 0x01};
    byte exp10[6] = {0x67, 0x01, 0x6C, 0xDD, 0x4E, 0xBF};
    SendAndCheck(req10, 2, exp10, 6, "step 10");
  }
}

/* Session change re-locks security level 0x1
 * category=security template=session_change_relocks_security requirements=REQ-005 origin=generated
 */
testcase TC_req_005__tpl_session_relock_01()
{
  testCaseTitle("req_005__tpl_session_relock_01", "Session change re-locks security level 0x1");
  // step 0: Switch to session 0x3.
  {
    byte req0[2] = {0x10, 0x03};
    byte exp0[6] = {0x50, 0x03, 0x00, 0x32, 0x01, 0xF4};
    SendAndCheck(req0, 2, exp0, 6, "step 0");
  }
  // step 1: Request seed for level 0x1.
  {
    byte req1[2] = {0x27, 0x01};
    byte exp1[6] = {0x67, 0x01, 0x95, 0x06, 0x77, 0xE8};
    SendAndCheck(req1, 2, exp1, 6, "step 1");
  }
  // step 2: Send computed key for level 0x1.
  {
    byte req2[6] = {0x27, 0x02, 0x9A, 0x06, 0x8F, 0x73};
    byte exp2[2] = {0x67, 0x02};
    SendAndCheck(req2, 6, exp2, 2, "step 2");
  }
  // step 3: Re-enter the same session -> security must be locked again.
  {
    byte req3[2] = {0x10, 0x03};
    byte exp3[6] = {0x50, 0x03, 0x00, 0x32, 0x01, 0xF4};
    SendAndCheck(req3, 2, exp3, 6, "step 3");
  }
  // step 4: Secured write to 0x0100 after re-entry -> expect NRC 0x33.
  {
    byte req4[4] = {0x2E, 0x01, 0x00, 0x00};
    byte exp4[3] = {0x7F, 0x2E, 0x33};
    SendAndCheck(req4, 4, exp4, 3, "step 4");
  }
  // step 5: Request seed -> a fresh non-zero seed (level is locked again).
  {
    byte req5[2] = {0x27, 0x01};
    byte exp5[6] = {0x67, 0x01, 0x32, 0xA3, 0x14, 0x85};
    SendAndCheck(req5, 2, exp5, 6, "step 5");
  }
}

/* Service 0x27 rejected in session 0x1
 * category=session template=service_not_in_session requirements=REQ-005 origin=generated
 */
testcase TC_req_005__tpl_service_not_in_session_27_01()
{
  testCaseTitle("req_005__tpl_service_not_in_session_27_01", "Service 0x27 rejected in session 0x1");
  // step 0: Service 0x27 not allowed in session 0x1 -> expect NRC 0x7F.
  {
    byte req0[2] = {0x27, 0x01};
    byte exp0[3] = {0x7F, 0x27, 0x7F};
    SendAndCheck(req0, 2, exp0, 3, "step 0");
  }
}

/* S3 timeout drops session 0x3 back to default
 * category=timing template=s3_timeout_reverts_session requirements=REQ-005 origin=generated
 */
testcase TC_req_005__tpl_s3_timeout_03()
{
  testCaseTitle("req_005__tpl_s3_timeout_03", "S3 timeout drops session 0x3 back to default");
  // step 0: Switch to session 0x3.
  {
    byte req0[2] = {0x10, 0x03};
    byte exp0[6] = {0x50, 0x03, 0x00, 0x32, 0x01, 0xF4};
    SendAndCheck(req0, 2, exp0, 6, "step 0");
  }
  // step 1: Advance past the S3 timer with no requests.
  testWaitForTimeout(5001);
  // step 2: Read active session DID -> expect it reports default session 0x01.
  {
    byte req2[3] = {0x22, 0xF1, 0x86};
    byte exp2[4] = {0x62, 0xF1, 0x86, 0x01};
    SendAndCheck(req2, 3, exp2, 4, "step 2");
  }
}

/* Write DID ambient_lighting_color_index (0x0101) after unlocking level 0x1
 * category=positive template=write_did_secured_positive requirements=REQ-006 origin=generated
 */
testcase TC_req_006__tpl_write_secured_0101()
{
  testCaseTitle("req_006__tpl_write_secured_0101", "Write DID ambient_lighting_color_index (0x0101) after unlocking level 0x1");
  // step 0: Switch to session 0x3.
  {
    byte req0[2] = {0x10, 0x03};
    byte exp0[6] = {0x50, 0x03, 0x00, 0x32, 0x01, 0xF4};
    SendAndCheck(req0, 2, exp0, 6, "step 0");
  }
  // step 1: Request seed for level 0x1.
  {
    byte req1[2] = {0x27, 0x01};
    byte exp1[6] = {0x67, 0x01, 0x95, 0x06, 0x77, 0xE8};
    SendAndCheck(req1, 2, exp1, 6, "step 1");
  }
  // step 2: Send computed key for level 0x1.
  {
    byte req2[6] = {0x27, 0x02, 0x9A, 0x06, 0x8F, 0x73};
    byte exp2[2] = {0x67, 0x02};
    SendAndCheck(req2, 6, exp2, 2, "step 2");
  }
  // step 3: Write 0 to DID 0x0101.
  {
    byte req3[4] = {0x2E, 0x01, 0x01, 0x00};
    byte exp3[3] = {0x6E, 0x01, 0x01};
    SendAndCheck(req3, 4, exp3, 3, "step 3");
  }
  // step 4: Read back to confirm the write.
  {
    byte req4[3] = {0x22, 0x01, 0x01};
    byte exp4[4] = {0x62, 0x01, 0x01, 0x00};
    SendAndCheck(req4, 3, exp4, 4, "step 4");
  }
}

/* Read DID ambient_lighting_color_index (0x0101) positively in session 0x3
 * category=positive template=read_did_positive requirements=REQ-006 origin=generated
 */
testcase TC_req_006__tpl_read_did_positive_0101_03()
{
  testCaseTitle("req_006__tpl_read_did_positive_0101_03", "Read DID ambient_lighting_color_index (0x0101) positively in session 0x3");
  // step 0: Switch to session 0x3.
  {
    byte req0[2] = {0x10, 0x03};
    byte exp0[6] = {0x50, 0x03, 0x00, 0x32, 0x01, 0xF4};
    SendAndCheck(req0, 2, exp0, 6, "step 0");
  }
  // step 1: Read DID 0x0101 (ambient_lighting_color_index) in session 0x3.
  {
    byte req1[3] = {0x22, 0x01, 0x01};
    byte exp1[4] = {0x62, 0x01, 0x01, 0x00};
    SendAndCheck(req1, 3, exp1, 4, "step 1");
  }
}

/* SecurityAccess level 0x1 lockout after 3 wrong keys
 * category=security template=security_invalid_key_lockout requirements=REQ-006 origin=generated
 */
testcase TC_req_006__tpl_security_lockout_01()
{
  testCaseTitle("req_006__tpl_security_lockout_01", "SecurityAccess level 0x1 lockout after 3 wrong keys");
  // step 0: Switch to session 0x3.
  {
    byte req0[2] = {0x10, 0x03};
    byte exp0[6] = {0x50, 0x03, 0x00, 0x32, 0x01, 0xF4};
    SendAndCheck(req0, 2, exp0, 6, "step 0");
  }
  // step 1: Request seed, attempt 1.
  {
    byte req1[2] = {0x27, 0x01};
    byte exp1[6] = {0x67, 0x01, 0x95, 0x06, 0x77, 0xE8};
    SendAndCheck(req1, 2, exp1, 6, "step 1");
  }
  // step 2: Send wrong key, attempt 1.
  {
    byte req2[6] = {0x27, 0x02, 0x96, 0x07, 0x78, 0xE9};
    byte exp2[3] = {0x7F, 0x27, 0x35};
    SendAndCheck(req2, 6, exp2, 3, "step 2");
  }
  // step 3: Request seed, attempt 2.
  {
    byte req3[2] = {0x27, 0x01};
    byte exp3[6] = {0x67, 0x01, 0x32, 0xA3, 0x14, 0x85};
    SendAndCheck(req3, 2, exp3, 6, "step 3");
  }
  // step 4: Send wrong key, attempt 2.
  {
    byte req4[6] = {0x27, 0x02, 0x33, 0xA4, 0x15, 0x86};
    byte exp4[3] = {0x7F, 0x27, 0x35};
    SendAndCheck(req4, 6, exp4, 3, "step 4");
  }
  // step 5: Request seed, attempt 3.
  {
    byte req5[2] = {0x27, 0x01};
    byte exp5[6] = {0x67, 0x01, 0xCF, 0x40, 0xB1, 0x22};
    SendAndCheck(req5, 2, exp5, 6, "step 5");
  }
  // step 6: Send wrong key, attempt 3.
  {
    byte req6[6] = {0x27, 0x02, 0xD0, 0x41, 0xB2, 0x23};
    byte exp6[3] = {0x7F, 0x27, 0x36};
    SendAndCheck(req6, 6, exp6, 3, "step 6");
  }
  // step 7: Request seed during lockout -> expect NRC 0x37.
  {
    byte req7[2] = {0x27, 0x01};
    byte exp7[3] = {0x7F, 0x27, 0x37};
    SendAndCheck(req7, 2, exp7, 3, "step 7");
  }
  // step 8: Advance past the lockout delay.
  testWaitForTimeout(10001);
  // step 9: Re-enter the session (S3 expired during the wait).
  {
    byte req9[2] = {0x10, 0x03};
    byte exp9[6] = {0x50, 0x03, 0x00, 0x32, 0x01, 0xF4};
    SendAndCheck(req9, 2, exp9, 6, "step 9");
  }
  // step 10: Request seed after delay expiry -> seed issued again.
  {
    byte req10[2] = {0x27, 0x01};
    byte exp10[6] = {0x67, 0x01, 0x6C, 0xDD, 0x4E, 0xBF};
    SendAndCheck(req10, 2, exp10, 6, "step 10");
  }
}

/* Session change re-locks security level 0x1
 * category=security template=session_change_relocks_security requirements=REQ-006 origin=generated
 */
testcase TC_req_006__tpl_session_relock_01()
{
  testCaseTitle("req_006__tpl_session_relock_01", "Session change re-locks security level 0x1");
  // step 0: Switch to session 0x3.
  {
    byte req0[2] = {0x10, 0x03};
    byte exp0[6] = {0x50, 0x03, 0x00, 0x32, 0x01, 0xF4};
    SendAndCheck(req0, 2, exp0, 6, "step 0");
  }
  // step 1: Request seed for level 0x1.
  {
    byte req1[2] = {0x27, 0x01};
    byte exp1[6] = {0x67, 0x01, 0x95, 0x06, 0x77, 0xE8};
    SendAndCheck(req1, 2, exp1, 6, "step 1");
  }
  // step 2: Send computed key for level 0x1.
  {
    byte req2[6] = {0x27, 0x02, 0x9A, 0x06, 0x8F, 0x73};
    byte exp2[2] = {0x67, 0x02};
    SendAndCheck(req2, 6, exp2, 2, "step 2");
  }
  // step 3: Re-enter the same session -> security must be locked again.
  {
    byte req3[2] = {0x10, 0x03};
    byte exp3[6] = {0x50, 0x03, 0x00, 0x32, 0x01, 0xF4};
    SendAndCheck(req3, 2, exp3, 6, "step 3");
  }
  // step 4: Secured write to 0x0100 after re-entry -> expect NRC 0x33.
  {
    byte req4[4] = {0x2E, 0x01, 0x00, 0x00};
    byte exp4[3] = {0x7F, 0x2E, 0x33};
    SendAndCheck(req4, 4, exp4, 3, "step 4");
  }
  // step 5: Request seed -> a fresh non-zero seed (level is locked again).
  {
    byte req5[2] = {0x27, 0x01};
    byte exp5[6] = {0x67, 0x01, 0x32, 0xA3, 0x14, 0x85};
    SendAndCheck(req5, 2, exp5, 6, "step 5");
  }
}

/* Service 0x27 rejected in session 0x1
 * category=session template=service_not_in_session requirements=REQ-006 origin=generated
 */
testcase TC_req_006__tpl_service_not_in_session_27_01()
{
  testCaseTitle("req_006__tpl_service_not_in_session_27_01", "Service 0x27 rejected in session 0x1");
  // step 0: Service 0x27 not allowed in session 0x1 -> expect NRC 0x7F.
  {
    byte req0[2] = {0x27, 0x01};
    byte exp0[3] = {0x7F, 0x27, 0x7F};
    SendAndCheck(req0, 2, exp0, 3, "step 0");
  }
}

/* S3 timeout drops session 0x3 back to default
 * category=timing template=s3_timeout_reverts_session requirements=REQ-006 origin=generated
 */
testcase TC_req_006__tpl_s3_timeout_03()
{
  testCaseTitle("req_006__tpl_s3_timeout_03", "S3 timeout drops session 0x3 back to default");
  // step 0: Switch to session 0x3.
  {
    byte req0[2] = {0x10, 0x03};
    byte exp0[6] = {0x50, 0x03, 0x00, 0x32, 0x01, 0xF4};
    SendAndCheck(req0, 2, exp0, 6, "step 0");
  }
  // step 1: Advance past the S3 timer with no requests.
  testWaitForTimeout(5001);
  // step 2: Read active session DID -> expect it reports default session 0x01.
  {
    byte req2[3] = {0x22, 0xF1, 0x86};
    byte exp2[4] = {0x62, 0xF1, 0x86, 0x01};
    SendAndCheck(req2, 3, exp2, 4, "step 2");
  }
}

/* Read DID wiper_sensitivity_level (0x0130) positively in session 0x1
 * category=positive template=read_did_positive requirements=REQ-007 origin=generated
 */
testcase TC_req_007__tpl_read_did_positive_0130_01()
{
  testCaseTitle("req_007__tpl_read_did_positive_0130_01", "Read DID wiper_sensitivity_level (0x0130) positively in session 0x1");
  // step 0: Read DID 0x0130 (wiper_sensitivity_level) in session 0x1.
  {
    byte req0[3] = {0x22, 0x01, 0x30};
    byte exp0[4] = {0x62, 0x01, 0x30, 0x03};
    SendAndCheck(req0, 3, exp0, 4, "step 0");
  }
}

/* Write DID wiper_sensitivity_level (0x0130) after unlocking level 0x1
 * category=positive template=write_did_secured_positive requirements=REQ-007 origin=generated
 */
testcase TC_req_007__tpl_write_secured_0130()
{
  testCaseTitle("req_007__tpl_write_secured_0130", "Write DID wiper_sensitivity_level (0x0130) after unlocking level 0x1");
  // step 0: Switch to session 0x3.
  {
    byte req0[2] = {0x10, 0x03};
    byte exp0[6] = {0x50, 0x03, 0x00, 0x32, 0x01, 0xF4};
    SendAndCheck(req0, 2, exp0, 6, "step 0");
  }
  // step 1: Request seed for level 0x1.
  {
    byte req1[2] = {0x27, 0x01};
    byte exp1[6] = {0x67, 0x01, 0x95, 0x06, 0x77, 0xE8};
    SendAndCheck(req1, 2, exp1, 6, "step 1");
  }
  // step 2: Send computed key for level 0x1.
  {
    byte req2[6] = {0x27, 0x02, 0x9A, 0x06, 0x8F, 0x73};
    byte exp2[2] = {0x67, 0x02};
    SendAndCheck(req2, 6, exp2, 2, "step 2");
  }
  // step 3: Write 1 to DID 0x0130.
  {
    byte req3[4] = {0x2E, 0x01, 0x30, 0x01};
    byte exp3[3] = {0x6E, 0x01, 0x30};
    SendAndCheck(req3, 4, exp3, 3, "step 3");
  }
  // step 4: Read back to confirm the write.
  {
    byte req4[3] = {0x22, 0x01, 0x30};
    byte exp4[4] = {0x62, 0x01, 0x30, 0x01};
    SendAndCheck(req4, 3, exp4, 4, "step 4");
  }
}

/* Write out-of-range value to DID wiper_sensitivity_level (0x0130)
 * category=negative template=write_did_out_of_range requirements=REQ-007 origin=generated
 */
testcase TC_req_007__tpl_write_oor_0130()
{
  testCaseTitle("req_007__tpl_write_oor_0130", "Write out-of-range value to DID wiper_sensitivity_level (0x0130)");
  // step 0: Switch to session 0x3.
  {
    byte req0[2] = {0x10, 0x03};
    byte exp0[6] = {0x50, 0x03, 0x00, 0x32, 0x01, 0xF4};
    SendAndCheck(req0, 2, exp0, 6, "step 0");
  }
  // step 1: Request seed for level 0x1.
  {
    byte req1[2] = {0x27, 0x01};
    byte exp1[6] = {0x67, 0x01, 0x95, 0x06, 0x77, 0xE8};
    SendAndCheck(req1, 2, exp1, 6, "step 1");
  }
  // step 2: Send computed key for level 0x1.
  {
    byte req2[6] = {0x27, 0x02, 0x9A, 0x06, 0x8F, 0x73};
    byte exp2[2] = {0x67, 0x02};
    SendAndCheck(req2, 6, exp2, 2, "step 2");
  }
  // step 3: Write out-of-range value 6 -> expect NRC 0x31.
  {
    byte req3[4] = {0x2E, 0x01, 0x30, 0x06};
    byte exp3[3] = {0x7F, 0x2E, 0x31};
    SendAndCheck(req3, 4, exp3, 3, "step 3");
  }
}

/* Write wrong-length data to DID wiper_sensitivity_level (0x0130)
 * category=negative template=write_did_invalid_length requirements=REQ-007 origin=generated
 */
testcase TC_req_007__tpl_write_badlen_0130()
{
  testCaseTitle("req_007__tpl_write_badlen_0130", "Write wrong-length data to DID wiper_sensitivity_level (0x0130)");
  // step 0: Switch to session 0x3.
  {
    byte req0[2] = {0x10, 0x03};
    byte exp0[6] = {0x50, 0x03, 0x00, 0x32, 0x01, 0xF4};
    SendAndCheck(req0, 2, exp0, 6, "step 0");
  }
  // step 1: Write with one extra data byte -> expect NRC 0x13.
  {
    byte req1[5] = {0x2E, 0x01, 0x30, 0x00, 0x00};
    byte exp1[3] = {0x7F, 0x2E, 0x13};
    SendAndCheck(req1, 5, exp1, 3, "step 1");
  }
}

/* Service 0x2e rejected in session 0x1
 * category=session template=service_not_in_session requirements=REQ-007 origin=generated
 */
testcase TC_req_007__tpl_service_not_in_session_2e_01()
{
  testCaseTitle("req_007__tpl_service_not_in_session_2e_01", "Service 0x2e rejected in session 0x1");
  // step 0: Service 0x2e not allowed in session 0x1 -> expect NRC 0x7F.
  {
    byte req0[4] = {0x2E, 0x01, 0x00, 0x00};
    byte exp0[3] = {0x7F, 0x2E, 0x7F};
    SendAndCheck(req0, 4, exp0, 3, "step 0");
  }
}

/* NRC priority: service 0x2e + unknown identifier in session 0x1
 * category=negative template=nrc_priority_session_over_identifier requirements=REQ-007 origin=generated
 */
testcase TC_req_007__tpl_nrc_priority_2e_01()
{
  testCaseTitle("req_007__tpl_nrc_priority_2e_01", "NRC priority: service 0x2e + unknown identifier in session 0x1");
  // step 0: Unknown DID 0xdead, service 0x2e not allowed in session 0x1 -> the session check (0x7F) wins over the identifier check (0x31).
  {
    byte req0[4] = {0x2E, 0xDE, 0xAD, 0x00};
    byte exp0[3] = {0x7F, 0x2E, 0x7F};
    SendAndCheck(req0, 4, exp0, 3, "step 0");
  }
}

/* Read DID interior_lighting_brightness_pct (0x0100) positively in session 0x1
 * category=positive template=read_did_positive requirements=REQ-008 origin=generated
 */
testcase TC_req_008__tpl_read_did_positive_0100_01()
{
  testCaseTitle("req_008__tpl_read_did_positive_0100_01", "Read DID interior_lighting_brightness_pct (0x0100) positively in session 0x1");
  // step 0: Read DID 0x0100 (interior_lighting_brightness_pct) in session 0x1.
  {
    byte req0[3] = {0x22, 0x01, 0x00};
    byte exp0[4] = {0x62, 0x01, 0x00, 0x32};
    SendAndCheck(req0, 3, exp0, 4, "step 0");
  }
}

/* Write DID interior_lighting_brightness_pct (0x0100) after unlocking level 0x1
 * category=positive template=write_did_secured_positive requirements=REQ-008 origin=generated
 */
testcase TC_req_008__tpl_write_secured_0100()
{
  testCaseTitle("req_008__tpl_write_secured_0100", "Write DID interior_lighting_brightness_pct (0x0100) after unlocking level 0x1");
  // step 0: Switch to session 0x3.
  {
    byte req0[2] = {0x10, 0x03};
    byte exp0[6] = {0x50, 0x03, 0x00, 0x32, 0x01, 0xF4};
    SendAndCheck(req0, 2, exp0, 6, "step 0");
  }
  // step 1: Request seed for level 0x1.
  {
    byte req1[2] = {0x27, 0x01};
    byte exp1[6] = {0x67, 0x01, 0x95, 0x06, 0x77, 0xE8};
    SendAndCheck(req1, 2, exp1, 6, "step 1");
  }
  // step 2: Send computed key for level 0x1.
  {
    byte req2[6] = {0x27, 0x02, 0x9A, 0x06, 0x8F, 0x73};
    byte exp2[2] = {0x67, 0x02};
    SendAndCheck(req2, 6, exp2, 2, "step 2");
  }
  // step 3: Write 0 to DID 0x0100.
  {
    byte req3[4] = {0x2E, 0x01, 0x00, 0x00};
    byte exp3[3] = {0x6E, 0x01, 0x00};
    SendAndCheck(req3, 4, exp3, 3, "step 3");
  }
  // step 4: Read back to confirm the write.
  {
    byte req4[3] = {0x22, 0x01, 0x00};
    byte exp4[4] = {0x62, 0x01, 0x00, 0x00};
    SendAndCheck(req4, 3, exp4, 4, "step 4");
  }
}

/* Write out-of-range value to DID interior_lighting_brightness_pct (0x0100)
 * category=negative template=write_did_out_of_range requirements=REQ-008 origin=generated
 */
testcase TC_req_008__tpl_write_oor_0100()
{
  testCaseTitle("req_008__tpl_write_oor_0100", "Write out-of-range value to DID interior_lighting_brightness_pct (0x0100)");
  // step 0: Switch to session 0x3.
  {
    byte req0[2] = {0x10, 0x03};
    byte exp0[6] = {0x50, 0x03, 0x00, 0x32, 0x01, 0xF4};
    SendAndCheck(req0, 2, exp0, 6, "step 0");
  }
  // step 1: Request seed for level 0x1.
  {
    byte req1[2] = {0x27, 0x01};
    byte exp1[6] = {0x67, 0x01, 0x95, 0x06, 0x77, 0xE8};
    SendAndCheck(req1, 2, exp1, 6, "step 1");
  }
  // step 2: Send computed key for level 0x1.
  {
    byte req2[6] = {0x27, 0x02, 0x9A, 0x06, 0x8F, 0x73};
    byte exp2[2] = {0x67, 0x02};
    SendAndCheck(req2, 6, exp2, 2, "step 2");
  }
  // step 3: Write out-of-range value 101 -> expect NRC 0x31.
  {
    byte req3[4] = {0x2E, 0x01, 0x00, 0x65};
    byte exp3[3] = {0x7F, 0x2E, 0x31};
    SendAndCheck(req3, 4, exp3, 3, "step 3");
  }
}

/* Write wrong-length data to DID interior_lighting_brightness_pct (0x0100)
 * category=negative template=write_did_invalid_length requirements=REQ-008 origin=generated
 */
testcase TC_req_008__tpl_write_badlen_0100()
{
  testCaseTitle("req_008__tpl_write_badlen_0100", "Write wrong-length data to DID interior_lighting_brightness_pct (0x0100)");
  // step 0: Switch to session 0x3.
  {
    byte req0[2] = {0x10, 0x03};
    byte exp0[6] = {0x50, 0x03, 0x00, 0x32, 0x01, 0xF4};
    SendAndCheck(req0, 2, exp0, 6, "step 0");
  }
  // step 1: Write with one extra data byte -> expect NRC 0x13.
  {
    byte req1[5] = {0x2E, 0x01, 0x00, 0x00, 0x00};
    byte exp1[3] = {0x7F, 0x2E, 0x13};
    SendAndCheck(req1, 5, exp1, 3, "step 1");
  }
}

/* Read DID factory_reset_flag (0x0150) positively in session 0x3
 * category=positive template=read_did_positive requirements=REQ-009 origin=generated
 */
testcase TC_req_009__tpl_read_did_positive_0150_03()
{
  testCaseTitle("req_009__tpl_read_did_positive_0150_03", "Read DID factory_reset_flag (0x0150) positively in session 0x3");
  // step 0: Switch to session 0x3.
  {
    byte req0[2] = {0x10, 0x03};
    byte exp0[6] = {0x50, 0x03, 0x00, 0x32, 0x01, 0xF4};
    SendAndCheck(req0, 2, exp0, 6, "step 0");
  }
  // step 1: Read DID 0x0150 (factory_reset_flag) in session 0x3.
  {
    byte req1[3] = {0x22, 0x01, 0x50};
    byte exp1[4] = {0x62, 0x01, 0x50, 0x00};
    SendAndCheck(req1, 3, exp1, 4, "step 1");
  }
}

/* Session change re-locks security level 0x3
 * category=security template=session_change_relocks_security requirements=REQ-009 origin=generated
 */
testcase TC_req_009__tpl_session_relock_03()
{
  testCaseTitle("req_009__tpl_session_relock_03", "Session change re-locks security level 0x3");
  // step 0: Switch to session 0x2.
  {
    byte req0[2] = {0x10, 0x02};
    byte exp0[6] = {0x50, 0x02, 0x00, 0x32, 0x01, 0xF4};
    SendAndCheck(req0, 2, exp0, 6, "step 0");
  }
  // step 1: Request seed for level 0x3.
  {
    byte req1[2] = {0x27, 0x03};
    byte exp1[6] = {0x67, 0x03, 0x0B, 0x7C, 0xED, 0x5E};
    SendAndCheck(req1, 2, exp1, 6, "step 1");
  }
  // step 2: Send computed key for level 0x3.
  {
    byte req2[6] = {0x27, 0x04, 0x20, 0xA9, 0x2D, 0xBA};
    byte exp2[2] = {0x67, 0x04};
    SendAndCheck(req2, 6, exp2, 2, "step 2");
  }
  // step 3: Re-enter the same session -> security must be locked again.
  {
    byte req3[2] = {0x10, 0x02};
    byte exp3[6] = {0x50, 0x02, 0x00, 0x32, 0x01, 0xF4};
    SendAndCheck(req3, 2, exp3, 6, "step 3");
  }
  // step 4: Secured write to 0x0160 after re-entry -> expect NRC 0x33.
  {
    byte req4[5] = {0x2E, 0x01, 0x60, 0x00, 0x00};
    byte exp4[3] = {0x7F, 0x2E, 0x33};
    SendAndCheck(req4, 5, exp4, 3, "step 4");
  }
  // step 5: Request seed -> a fresh non-zero seed (level is locked again).
  {
    byte req5[2] = {0x27, 0x03};
    byte exp5[6] = {0x67, 0x03, 0xA8, 0x19, 0x8A, 0xFB};
    SendAndCheck(req5, 2, exp5, 6, "step 5");
  }
}

/* Negative response not suppressed for service 0x10 in session 0x3
 * category=negative template=negative_response_with_suppress_bit requirements=REQ-009 origin=generated
 */
testcase TC_req_009__tpl_negative_suppress_10_03()
{
  testCaseTitle("req_009__tpl_negative_suppress_10_03", "Negative response not suppressed for service 0x10 in session 0x3");
  // step 0: Switch to session 0x3.
  {
    byte req0[2] = {0x10, 0x03};
    byte exp0[6] = {0x50, 0x03, 0x00, 0x32, 0x01, 0xF4};
    SendAndCheck(req0, 2, exp0, 6, "step 0");
  }
  // step 1: Unsupported subfunction 0x7 with the suppress bit set -> the NRC is still sent.
  {
    byte req1[2] = {0x10, 0x87};
    byte exp1[3] = {0x7F, 0x10, 0x12};
    SendAndCheck(req1, 2, exp1, 3, "step 1");
  }
}

/* Service 0x27 rejected in session 0x1
 * category=session template=service_not_in_session requirements=REQ-009 origin=generated
 */
testcase TC_req_009__tpl_service_not_in_session_27_01()
{
  testCaseTitle("req_009__tpl_service_not_in_session_27_01", "Service 0x27 rejected in session 0x1");
  // step 0: Service 0x27 not allowed in session 0x1 -> expect NRC 0x7F.
  {
    byte req0[2] = {0x27, 0x01};
    byte exp0[3] = {0x7F, 0x27, 0x7F};
    SendAndCheck(req0, 2, exp0, 3, "step 0");
  }
}

/* S3 timeout drops session 0x2 back to default
 * category=timing template=s3_timeout_reverts_session requirements=REQ-009 origin=generated
 */
testcase TC_req_009__tpl_s3_timeout_02()
{
  testCaseTitle("req_009__tpl_s3_timeout_02", "S3 timeout drops session 0x2 back to default");
  // step 0: Switch to session 0x2.
  {
    byte req0[2] = {0x10, 0x02};
    byte exp0[6] = {0x50, 0x02, 0x00, 0x32, 0x01, 0xF4};
    SendAndCheck(req0, 2, exp0, 6, "step 0");
  }
  // step 1: Advance past the S3 timer with no requests.
  testWaitForTimeout(5001);
  // step 2: Read active session DID -> expect it reports default session 0x01.
  {
    byte req2[3] = {0x22, 0xF1, 0x86};
    byte exp2[4] = {0x62, 0xF1, 0x86, 0x01};
    SendAndCheck(req2, 3, exp2, 4, "step 2");
  }
}

/* Write DID ambient_lighting_color_index (0x0101) after unlocking level 0x1
 * category=positive template=write_did_secured_positive requirements=REQ-010 origin=generated
 */
testcase TC_req_010__tpl_write_secured_0101()
{
  testCaseTitle("req_010__tpl_write_secured_0101", "Write DID ambient_lighting_color_index (0x0101) after unlocking level 0x1");
  // step 0: Switch to session 0x3.
  {
    byte req0[2] = {0x10, 0x03};
    byte exp0[6] = {0x50, 0x03, 0x00, 0x32, 0x01, 0xF4};
    SendAndCheck(req0, 2, exp0, 6, "step 0");
  }
  // step 1: Request seed for level 0x1.
  {
    byte req1[2] = {0x27, 0x01};
    byte exp1[6] = {0x67, 0x01, 0x95, 0x06, 0x77, 0xE8};
    SendAndCheck(req1, 2, exp1, 6, "step 1");
  }
  // step 2: Send computed key for level 0x1.
  {
    byte req2[6] = {0x27, 0x02, 0x9A, 0x06, 0x8F, 0x73};
    byte exp2[2] = {0x67, 0x02};
    SendAndCheck(req2, 6, exp2, 2, "step 2");
  }
  // step 3: Write 0 to DID 0x0101.
  {
    byte req3[4] = {0x2E, 0x01, 0x01, 0x00};
    byte exp3[3] = {0x6E, 0x01, 0x01};
    SendAndCheck(req3, 4, exp3, 3, "step 3");
  }
  // step 4: Read back to confirm the write.
  {
    byte req4[3] = {0x22, 0x01, 0x01};
    byte exp4[4] = {0x62, 0x01, 0x01, 0x00};
    SendAndCheck(req4, 3, exp4, 4, "step 4");
  }
}

/* Read DID ambient_lighting_color_index (0x0101) positively in session 0x2
 * category=positive template=read_did_positive requirements=REQ-010 origin=generated
 */
testcase TC_req_010__tpl_read_did_positive_0101_02()
{
  testCaseTitle("req_010__tpl_read_did_positive_0101_02", "Read DID ambient_lighting_color_index (0x0101) positively in session 0x2");
  // step 0: Switch to session 0x2.
  {
    byte req0[2] = {0x10, 0x02};
    byte exp0[6] = {0x50, 0x02, 0x00, 0x32, 0x01, 0xF4};
    SendAndCheck(req0, 2, exp0, 6, "step 0");
  }
  // step 1: Read DID 0x0101 (ambient_lighting_color_index) in session 0x2.
  {
    byte req1[3] = {0x22, 0x01, 0x01};
    byte exp1[4] = {0x62, 0x01, 0x01, 0x00};
    SendAndCheck(req1, 3, exp1, 4, "step 1");
  }
}

/* SecurityAccess level 0x1 lockout after 3 wrong keys
 * category=security template=security_invalid_key_lockout requirements=REQ-010 origin=generated
 */
testcase TC_req_010__tpl_security_lockout_01()
{
  testCaseTitle("req_010__tpl_security_lockout_01", "SecurityAccess level 0x1 lockout after 3 wrong keys");
  // step 0: Switch to session 0x3.
  {
    byte req0[2] = {0x10, 0x03};
    byte exp0[6] = {0x50, 0x03, 0x00, 0x32, 0x01, 0xF4};
    SendAndCheck(req0, 2, exp0, 6, "step 0");
  }
  // step 1: Request seed, attempt 1.
  {
    byte req1[2] = {0x27, 0x01};
    byte exp1[6] = {0x67, 0x01, 0x95, 0x06, 0x77, 0xE8};
    SendAndCheck(req1, 2, exp1, 6, "step 1");
  }
  // step 2: Send wrong key, attempt 1.
  {
    byte req2[6] = {0x27, 0x02, 0x96, 0x07, 0x78, 0xE9};
    byte exp2[3] = {0x7F, 0x27, 0x35};
    SendAndCheck(req2, 6, exp2, 3, "step 2");
  }
  // step 3: Request seed, attempt 2.
  {
    byte req3[2] = {0x27, 0x01};
    byte exp3[6] = {0x67, 0x01, 0x32, 0xA3, 0x14, 0x85};
    SendAndCheck(req3, 2, exp3, 6, "step 3");
  }
  // step 4: Send wrong key, attempt 2.
  {
    byte req4[6] = {0x27, 0x02, 0x33, 0xA4, 0x15, 0x86};
    byte exp4[3] = {0x7F, 0x27, 0x35};
    SendAndCheck(req4, 6, exp4, 3, "step 4");
  }
  // step 5: Request seed, attempt 3.
  {
    byte req5[2] = {0x27, 0x01};
    byte exp5[6] = {0x67, 0x01, 0xCF, 0x40, 0xB1, 0x22};
    SendAndCheck(req5, 2, exp5, 6, "step 5");
  }
  // step 6: Send wrong key, attempt 3.
  {
    byte req6[6] = {0x27, 0x02, 0xD0, 0x41, 0xB2, 0x23};
    byte exp6[3] = {0x7F, 0x27, 0x36};
    SendAndCheck(req6, 6, exp6, 3, "step 6");
  }
  // step 7: Request seed during lockout -> expect NRC 0x37.
  {
    byte req7[2] = {0x27, 0x01};
    byte exp7[3] = {0x7F, 0x27, 0x37};
    SendAndCheck(req7, 2, exp7, 3, "step 7");
  }
  // step 8: Advance past the lockout delay.
  testWaitForTimeout(10001);
  // step 9: Re-enter the session (S3 expired during the wait).
  {
    byte req9[2] = {0x10, 0x03};
    byte exp9[6] = {0x50, 0x03, 0x00, 0x32, 0x01, 0xF4};
    SendAndCheck(req9, 2, exp9, 6, "step 9");
  }
  // step 10: Request seed after delay expiry -> seed issued again.
  {
    byte req10[2] = {0x27, 0x01};
    byte exp10[6] = {0x67, 0x01, 0x6C, 0xDD, 0x4E, 0xBF};
    SendAndCheck(req10, 2, exp10, 6, "step 10");
  }
}

/* Service 0x27 rejected in session 0x1
 * category=session template=service_not_in_session requirements=REQ-010 origin=generated
 */
testcase TC_req_010__tpl_service_not_in_session_27_01()
{
  testCaseTitle("req_010__tpl_service_not_in_session_27_01", "Service 0x27 rejected in session 0x1");
  // step 0: Service 0x27 not allowed in session 0x1 -> expect NRC 0x7F.
  {
    byte req0[2] = {0x27, 0x01};
    byte exp0[3] = {0x7F, 0x27, 0x7F};
    SendAndCheck(req0, 2, exp0, 3, "step 0");
  }
}

/* Replayed SecurityAccess key for level 0x1 is rejected
 * category=security template=seed_replay_rejected requirements=REQ-010 origin=generated
 */
testcase TC_req_010__tpl_seed_replay_01()
{
  testCaseTitle("req_010__tpl_seed_replay_01", "Replayed SecurityAccess key for level 0x1 is rejected");
  // step 0: Switch to session 0x3.
  {
    byte req0[2] = {0x10, 0x03};
    byte exp0[6] = {0x50, 0x03, 0x00, 0x32, 0x01, 0xF4};
    SendAndCheck(req0, 2, exp0, 6, "step 0");
  }
  // step 1: Request seed.
  {
    byte req1[2] = {0x27, 0x01};
    byte exp1[6] = {0x67, 0x01, 0x95, 0x06, 0x77, 0xE8};
    SendAndCheck(req1, 2, exp1, 6, "step 1");
  }
  // step 2: Send the computed key -> unlocked.
  {
    byte req2[6] = {0x27, 0x02, 0x9A, 0x06, 0x8F, 0x73};
    byte exp2[2] = {0x67, 0x02};
    SendAndCheck(req2, 6, exp2, 2, "step 2");
  }
  // step 3: Replay the same key -> expect NRC 0x24 (the seed was consumed).
  {
    byte req3[6] = {0x27, 0x02, 0x9A, 0x06, 0x8F, 0x73};
    byte exp3[3] = {0x7F, 0x27, 0x24};
    SendAndCheck(req3, 6, exp3, 3, "step 3");
  }
}

/* Start routine lighting_self_test (0x0201) and read its results
 * category=positive template=routine_start_results requirements=REQ-011 origin=generated
 */
testcase TC_req_011__tpl_routine_start_results_0201()
{
  testCaseTitle("req_011__tpl_routine_start_results_0201", "Start routine lighting_self_test (0x0201) and read its results");
  // step 0: Switch to session 0x3.
  {
    byte req0[2] = {0x10, 0x03};
    byte exp0[6] = {0x50, 0x03, 0x00, 0x32, 0x01, 0xF4};
    SendAndCheck(req0, 2, exp0, 6, "step 0");
  }
  // step 1: Request seed for level 0x1.
  {
    byte req1[2] = {0x27, 0x01};
    byte exp1[6] = {0x67, 0x01, 0x95, 0x06, 0x77, 0xE8};
    SendAndCheck(req1, 2, exp1, 6, "step 1");
  }
  // step 2: Send computed key for level 0x1.
  {
    byte req2[6] = {0x27, 0x02, 0x9A, 0x06, 0x8F, 0x73};
    byte exp2[2] = {0x67, 0x02};
    SendAndCheck(req2, 6, exp2, 2, "step 2");
  }
  // step 3: Start the routine.
  {
    byte req3[4] = {0x31, 0x01, 0x02, 0x01};
    byte exp3[5] = {0x71, 0x01, 0x02, 0x01, 0x01};
    SendAndCheck(req3, 4, exp3, 5, "step 3");
  }
  // step 4: Request routine results.
  {
    byte req4[4] = {0x31, 0x03, 0x02, 0x01};
    byte exp4[5] = {0x71, 0x03, 0x02, 0x01, 0x01};
    SendAndCheck(req4, 4, exp4, 5, "step 4");
  }
}

/* Negative response not suppressed for service 0x31 in session 0x2
 * category=negative template=negative_response_with_suppress_bit requirements=REQ-011 origin=generated
 */
testcase TC_req_011__tpl_negative_suppress_31_02()
{
  testCaseTitle("req_011__tpl_negative_suppress_31_02", "Negative response not suppressed for service 0x31 in session 0x2");
  // step 0: Switch to session 0x2.
  {
    byte req0[2] = {0x10, 0x02};
    byte exp0[6] = {0x50, 0x02, 0x00, 0x32, 0x01, 0xF4};
    SendAndCheck(req0, 2, exp0, 6, "step 0");
  }
  // step 1: Unsupported subfunction 0x4 with the suppress bit set -> the NRC is still sent.
  {
    byte req1[4] = {0x31, 0x84, 0x02, 0x01};
    byte exp1[3] = {0x7F, 0x31, 0x12};
    SendAndCheck(req1, 4, exp1, 3, "step 1");
  }
}

/* Start routine door_actuator_calibration while vehicle is moving
 * category=negative template=condition_not_met requirements=REQ-011 origin=generated
 */
testcase TC_req_011__tpl_condition_not_met_routine_0202()
{
  testCaseTitle("req_011__tpl_condition_not_met_routine_0202", "Start routine door_actuator_calibration while vehicle is moving");
  // step 0: Switch to session 0x3.
  {
    byte req0[2] = {0x10, 0x03};
    byte exp0[6] = {0x50, 0x03, 0x00, 0x32, 0x01, 0xF4};
    SendAndCheck(req0, 2, exp0, 6, "step 0");
  }
  // step 1: TODO set environment on the bench: vehicle_speed_kph=10 nvm_write_fault=None
  // step 2: Request seed for level 0x1.
  {
    byte req2[2] = {0x27, 0x01};
    byte exp2[6] = {0x67, 0x01, 0x95, 0x06, 0x77, 0xE8};
    SendAndCheck(req2, 2, exp2, 6, "step 2");
  }
  // step 3: Send computed key for level 0x1.
  {
    byte req3[6] = {0x27, 0x02, 0x9A, 0x06, 0x8F, 0x73};
    byte exp3[2] = {0x67, 0x02};
    SendAndCheck(req3, 6, exp3, 2, "step 3");
  }
  // step 4: Start routine while vehicle is moving -> expect NRC 0x22.
  {
    byte req4[5] = {0x31, 0x01, 0x02, 0x02, 0x00};
    byte exp4[3] = {0x7F, 0x31, 0x22};
    SendAndCheck(req4, 5, exp4, 3, "step 4");
  }
}

/* Negative response not suppressed for service 0x31 in session 0x3
 * category=negative template=negative_response_with_suppress_bit requirements=REQ-011 origin=generated
 */
testcase TC_req_011__tpl_negative_suppress_31_03()
{
  testCaseTitle("req_011__tpl_negative_suppress_31_03", "Negative response not suppressed for service 0x31 in session 0x3");
  // step 0: Switch to session 0x3.
  {
    byte req0[2] = {0x10, 0x03};
    byte exp0[6] = {0x50, 0x03, 0x00, 0x32, 0x01, 0xF4};
    SendAndCheck(req0, 2, exp0, 6, "step 0");
  }
  // step 1: Unsupported subfunction 0x4 with the suppress bit set -> the NRC is still sent.
  {
    byte req1[4] = {0x31, 0x84, 0x02, 0x01};
    byte exp1[3] = {0x7F, 0x31, 0x12};
    SendAndCheck(req1, 4, exp1, 3, "step 1");
  }
}

/* NRC priority: service 0x31 + unknown identifier in session 0x1
 * category=negative template=nrc_priority_session_over_identifier requirements=REQ-011 origin=generated
 */
testcase TC_req_011__tpl_nrc_priority_31_01()
{
  testCaseTitle("req_011__tpl_nrc_priority_31_01", "NRC priority: service 0x31 + unknown identifier in session 0x1");
  // step 0: Unknown routine 0xdead, service 0x31 not allowed in session 0x1 -> the session check (0x7F) wins over the identifier check (0x31).
  {
    byte req0[4] = {0x31, 0x01, 0xDE, 0xAD};
    byte exp0[3] = {0x7F, 0x31, 0x7F};
    SendAndCheck(req0, 4, exp0, 3, "step 0");
  }
}

/* Write DID ambient_lighting_color_index (0x0101) after unlocking level 0x1
 * category=positive template=write_did_secured_positive requirements=REQ-012 origin=generated
 */
testcase TC_req_012__tpl_write_secured_0101()
{
  testCaseTitle("req_012__tpl_write_secured_0101", "Write DID ambient_lighting_color_index (0x0101) after unlocking level 0x1");
  // step 0: Switch to session 0x3.
  {
    byte req0[2] = {0x10, 0x03};
    byte exp0[6] = {0x50, 0x03, 0x00, 0x32, 0x01, 0xF4};
    SendAndCheck(req0, 2, exp0, 6, "step 0");
  }
  // step 1: Request seed for level 0x1.
  {
    byte req1[2] = {0x27, 0x01};
    byte exp1[6] = {0x67, 0x01, 0x95, 0x06, 0x77, 0xE8};
    SendAndCheck(req1, 2, exp1, 6, "step 1");
  }
  // step 2: Send computed key for level 0x1.
  {
    byte req2[6] = {0x27, 0x02, 0x9A, 0x06, 0x8F, 0x73};
    byte exp2[2] = {0x67, 0x02};
    SendAndCheck(req2, 6, exp2, 2, "step 2");
  }
  // step 3: Write 0 to DID 0x0101.
  {
    byte req3[4] = {0x2E, 0x01, 0x01, 0x00};
    byte exp3[3] = {0x6E, 0x01, 0x01};
    SendAndCheck(req3, 4, exp3, 3, "step 3");
  }
  // step 4: Read back to confirm the write.
  {
    byte req4[3] = {0x22, 0x01, 0x01};
    byte exp4[4] = {0x62, 0x01, 0x01, 0x00};
    SendAndCheck(req4, 3, exp4, 4, "step 4");
  }
}

/* Read DID ambient_lighting_color_index (0x0101) positively in session 0x2
 * category=positive template=read_did_positive requirements=REQ-012 origin=generated
 */
testcase TC_req_012__tpl_read_did_positive_0101_02()
{
  testCaseTitle("req_012__tpl_read_did_positive_0101_02", "Read DID ambient_lighting_color_index (0x0101) positively in session 0x2");
  // step 0: Switch to session 0x2.
  {
    byte req0[2] = {0x10, 0x02};
    byte exp0[6] = {0x50, 0x02, 0x00, 0x32, 0x01, 0xF4};
    SendAndCheck(req0, 2, exp0, 6, "step 0");
  }
  // step 1: Read DID 0x0101 (ambient_lighting_color_index) in session 0x2.
  {
    byte req1[3] = {0x22, 0x01, 0x01};
    byte exp1[4] = {0x62, 0x01, 0x01, 0x00};
    SendAndCheck(req1, 3, exp1, 4, "step 1");
  }
}

/* Service 0x31 rejected in session 0x1
 * category=session template=service_not_in_session requirements=REQ-012 origin=generated
 */
testcase TC_req_012__tpl_service_not_in_session_31_01()
{
  testCaseTitle("req_012__tpl_service_not_in_session_31_01", "Service 0x31 rejected in session 0x1");
  // step 0: Service 0x31 not allowed in session 0x1 -> expect NRC 0x7F.
  {
    byte req0[4] = {0x31, 0x01, 0x02, 0x01};
    byte exp0[3] = {0x7F, 0x31, 0x7F};
    SendAndCheck(req0, 4, exp0, 3, "step 0");
  }
}

/* Negative response not suppressed for service 0x31 in session 0x3
 * category=negative template=negative_response_with_suppress_bit requirements=REQ-012 origin=generated
 */
testcase TC_req_012__tpl_negative_suppress_31_03()
{
  testCaseTitle("req_012__tpl_negative_suppress_31_03", "Negative response not suppressed for service 0x31 in session 0x3");
  // step 0: Switch to session 0x3.
  {
    byte req0[2] = {0x10, 0x03};
    byte exp0[6] = {0x50, 0x03, 0x00, 0x32, 0x01, 0xF4};
    SendAndCheck(req0, 2, exp0, 6, "step 0");
  }
  // step 1: Unsupported subfunction 0x4 with the suppress bit set -> the NRC is still sent.
  {
    byte req1[4] = {0x31, 0x84, 0x02, 0x01};
    byte exp1[3] = {0x7F, 0x31, 0x12};
    SendAndCheck(req1, 4, exp1, 3, "step 1");
  }
}

/* Read DID vehicle_speed_kph (0x0140) positively in session 0x1
 * category=positive template=read_did_positive requirements=REQ-013 origin=generated
 */
testcase TC_req_013__tpl_read_did_positive_0140_01()
{
  testCaseTitle("req_013__tpl_read_did_positive_0140_01", "Read DID vehicle_speed_kph (0x0140) positively in session 0x1");
  // step 0: Read DID 0x0140 (vehicle_speed_kph) in session 0x1.
  {
    byte req0[3] = {0x22, 0x01, 0x40};
    byte exp0[4] = {0x62, 0x01, 0x40, 0x00};
    SendAndCheck(req0, 3, exp0, 4, "step 0");
  }
}

/* Write to read-only DID vehicle_speed_kph (0x0140) is rejected
 * category=negative template=write_readonly_did requirements=REQ-013 origin=generated
 */
testcase TC_req_013__tpl_write_readonly_0140()
{
  testCaseTitle("req_013__tpl_write_readonly_0140", "Write to read-only DID vehicle_speed_kph (0x0140) is rejected");
  // step 0: Switch to session 0x2.
  {
    byte req0[2] = {0x10, 0x02};
    byte exp0[6] = {0x50, 0x02, 0x00, 0x32, 0x01, 0xF4};
    SendAndCheck(req0, 2, exp0, 6, "step 0");
  }
  // step 1: Write a read-only DID -> expect NRC 0x31 (identifier not writable).
  {
    byte req1[4] = {0x2E, 0x01, 0x40, 0x00};
    byte exp1[3] = {0x7F, 0x2E, 0x31};
    SendAndCheck(req1, 4, exp1, 3, "step 1");
  }
  // step 2: Read back -> value unchanged.
  {
    byte req2[3] = {0x22, 0x01, 0x40};
    byte exp2[4] = {0x62, 0x01, 0x40, 0x00};
    SendAndCheck(req2, 3, exp2, 4, "step 2");
  }
}

/* Unsupported subfunction for service 0x11 in session 0x1
 * category=negative template=unsupported_subfunction requirements=REQ-013 origin=generated
 */
testcase TC_req_013__tpl_unsupported_subfunction_11_01()
{
  testCaseTitle("req_013__tpl_unsupported_subfunction_11_01", "Unsupported subfunction for service 0x11 in session 0x1");
  // step 0: Unsupported subfunction 0x2 for service 0x11 -> expect NRC 0x12.
  {
    byte req0[2] = {0x11, 0x02};
    byte exp0[3] = {0x7F, 0x11, 0x12};
    SendAndCheck(req0, 2, exp0, 3, "step 0");
  }
}

/* Negative response not suppressed for service 0x11 in session 0x1
 * category=negative template=negative_response_with_suppress_bit requirements=REQ-013 origin=generated
 */
testcase TC_req_013__tpl_negative_suppress_11_01()
{
  testCaseTitle("req_013__tpl_negative_suppress_11_01", "Negative response not suppressed for service 0x11 in session 0x1");
  // step 0: Unsupported subfunction 0x2 with the suppress bit set -> the NRC is still sent.
  {
    byte req0[2] = {0x11, 0x82};
    byte exp0[3] = {0x7F, 0x11, 0x12};
    SendAndCheck(req0, 2, exp0, 3, "step 0");
  }
}

/* Multi-DID read vehicle_speed_kph + VIN in session 0x1
 * category=positive template=read_multiple_dids requirements=REQ-014 origin=generated
 */
testcase TC_req_014__tpl_read_multi_0140_f190_01()
{
  testCaseTitle("req_014__tpl_read_multi_0140_f190_01", "Multi-DID read vehicle_speed_kph + VIN in session 0x1");
  // step 0: Read DIDs 0x0140, 0xf190 in one request -> every record, in order.
  {
    byte req0[5] = {0x22, 0x01, 0x40, 0xF1, 0x90};
    byte exp0[23] = {0x62, 0x01, 0x40, 0x00, 0xF1, 0x90, 0x53, 0x59, 0x4E, 0x54, 0x48, 0x45, 0x54, 0x49, 0x43, 0x42, 0x4D, 0x30, 0x30, 0x30, 0x30, 0x30, 0x31};
    SendAndCheck(req0, 5, exp0, 23, "step 0");
  }
}

/* Service 0x19 rejected in session 0x2
 * category=session template=service_not_in_session requirements=REQ-014 origin=generated
 */
testcase TC_req_014__tpl_service_not_in_session_19_02()
{
  testCaseTitle("req_014__tpl_service_not_in_session_19_02", "Service 0x19 rejected in session 0x2");
  // step 0: Switch to session 0x2.
  {
    byte req0[2] = {0x10, 0x02};
    byte exp0[6] = {0x50, 0x02, 0x00, 0x32, 0x01, 0xF4};
    SendAndCheck(req0, 2, exp0, 6, "step 0");
  }
  // step 1: Service 0x19 not allowed in session 0x2 -> expect NRC 0x7F.
  {
    byte req1[3] = {0x19, 0x02, 0xFF};
    byte exp1[3] = {0x7F, 0x19, 0x7F};
    SendAndCheck(req1, 3, exp1, 3, "step 1");
  }
}

/* Unsupported subfunction for service 0x19 in session 0x3
 * category=negative template=unsupported_subfunction requirements=REQ-014 origin=generated
 */
testcase TC_req_014__tpl_unsupported_subfunction_19_03()
{
  testCaseTitle("req_014__tpl_unsupported_subfunction_19_03", "Unsupported subfunction for service 0x19 in session 0x3");
  // step 0: Switch to session 0x3.
  {
    byte req0[2] = {0x10, 0x03};
    byte exp0[6] = {0x50, 0x03, 0x00, 0x32, 0x01, 0xF4};
    SendAndCheck(req0, 2, exp0, 6, "step 0");
  }
  // step 1: Unsupported subfunction 0x1 for service 0x19 -> expect NRC 0x12.
  {
    byte req1[3] = {0x19, 0x01, 0xFF};
    byte exp1[3] = {0x7F, 0x19, 0x12};
    SendAndCheck(req1, 3, exp1, 3, "step 1");
  }
}

/* Read DID interior_lighting_brightness_pct (0x0100) positively in session 0x1
 * category=positive template=read_did_positive requirements=REQ-015 origin=generated
 */
testcase TC_req_015__tpl_read_did_positive_0100_01()
{
  testCaseTitle("req_015__tpl_read_did_positive_0100_01", "Read DID interior_lighting_brightness_pct (0x0100) positively in session 0x1");
  // step 0: Read DID 0x0100 (interior_lighting_brightness_pct) in session 0x1.
  {
    byte req0[3] = {0x22, 0x01, 0x00};
    byte exp0[4] = {0x62, 0x01, 0x00, 0x32};
    SendAndCheck(req0, 3, exp0, 4, "step 0");
  }
}

/* Write DID interior_lighting_brightness_pct (0x0100) after unlocking level 0x1
 * category=positive template=write_did_secured_positive requirements=REQ-015 origin=generated
 */
testcase TC_req_015__tpl_write_secured_0100()
{
  testCaseTitle("req_015__tpl_write_secured_0100", "Write DID interior_lighting_brightness_pct (0x0100) after unlocking level 0x1");
  // step 0: Switch to session 0x3.
  {
    byte req0[2] = {0x10, 0x03};
    byte exp0[6] = {0x50, 0x03, 0x00, 0x32, 0x01, 0xF4};
    SendAndCheck(req0, 2, exp0, 6, "step 0");
  }
  // step 1: Request seed for level 0x1.
  {
    byte req1[2] = {0x27, 0x01};
    byte exp1[6] = {0x67, 0x01, 0x95, 0x06, 0x77, 0xE8};
    SendAndCheck(req1, 2, exp1, 6, "step 1");
  }
  // step 2: Send computed key for level 0x1.
  {
    byte req2[6] = {0x27, 0x02, 0x9A, 0x06, 0x8F, 0x73};
    byte exp2[2] = {0x67, 0x02};
    SendAndCheck(req2, 6, exp2, 2, "step 2");
  }
  // step 3: Write 0 to DID 0x0100.
  {
    byte req3[4] = {0x2E, 0x01, 0x00, 0x00};
    byte exp3[3] = {0x6E, 0x01, 0x00};
    SendAndCheck(req3, 4, exp3, 3, "step 3");
  }
  // step 4: Read back to confirm the write.
  {
    byte req4[3] = {0x22, 0x01, 0x00};
    byte exp4[4] = {0x62, 0x01, 0x00, 0x00};
    SendAndCheck(req4, 3, exp4, 4, "step 4");
  }
}

/* TesterPresent keeps session 0x3 alive at the S3 boundary
 * category=timing template=s3_keepalive_boundary requirements=REQ-015 origin=generated
 */
testcase TC_req_015__tpl_s3_keepalive_03()
{
  testCaseTitle("req_015__tpl_s3_keepalive_03", "TesterPresent keeps session 0x3 alive at the S3 boundary");
  // step 0: Switch to session 0x3.
  {
    byte req0[2] = {0x10, 0x03};
    byte exp0[6] = {0x50, 0x03, 0x00, 0x32, 0x01, 0xF4};
    SendAndCheck(req0, 2, exp0, 6, "step 0");
  }
  // step 1: Stay silent for exactly S3.
  testWaitForTimeout(5000);
  // step 2: TesterPresent exactly at S3 -> still served.
  {
    byte req2[2] = {0x3E, 0x00};
    byte exp2[2] = {0x7E, 0x00};
    SendAndCheck(req2, 2, exp2, 2, "step 2");
  }
  // step 3: Silent for exactly S3 again (timer restarted by TesterPresent).
  testWaitForTimeout(5000);
  // step 4: Read the active session -> still the non-default session.
  {
    byte req4[3] = {0x22, 0xF1, 0x86};
    byte exp4[4] = {0x62, 0xF1, 0x86, 0x03};
    SendAndCheck(req4, 3, exp4, 4, "step 4");
  }
}

/* Negative response not suppressed for service 0x3e in session 0x2
 * category=negative template=negative_response_with_suppress_bit requirements=REQ-015 origin=generated
 */
testcase TC_req_015__tpl_negative_suppress_3e_02()
{
  testCaseTitle("req_015__tpl_negative_suppress_3e_02", "Negative response not suppressed for service 0x3e in session 0x2");
  // step 0: Switch to session 0x2.
  {
    byte req0[2] = {0x10, 0x02};
    byte exp0[6] = {0x50, 0x02, 0x00, 0x32, 0x01, 0xF4};
    SendAndCheck(req0, 2, exp0, 6, "step 0");
  }
  // step 1: Unsupported subfunction 0x1 with the suppress bit set -> the NRC is still sent.
  {
    byte req1[2] = {0x3E, 0x81};
    byte exp1[3] = {0x7F, 0x3E, 0x12};
    SendAndCheck(req1, 2, exp1, 3, "step 1");
  }
}


/* Test module entry point: runs every exported test case. */
void MainTest()
{
  TC_req_001__tpl_read_did_positive_f190_01();
  TC_req_001__tpl_read_did_positive_f190_02();
  TC_req_001__tpl_read_did_positive_f190_03();
  TC_req_002__tpl_read_did_positive_f187_01();
  TC_req_002__tpl_read_did_positive_f187_02();
  TC_req_002__tpl_read_did_positive_f187_03();
  TC_req_002__tpl_read_did_positive_f18c_01();
  TC_req_002__tpl_read_multi_f187_f190_01();
  TC_req_003__tpl_read_did_positive_f186_01();
  TC_req_003__tpl_s3_timeout_03();
  TC_req_003__tpl_session_relock_01();
  TC_req_003__tpl_suppress_positive_10_01();
  TC_req_004__tpl_condition_not_met_did_0150();
  TC_req_004__tpl_read_did_positive_f190_01();
  TC_req_004__tpl_write_nosec_0100();
  TC_req_004__tpl_write_oor_0100();
  TC_req_005__tpl_read_did_positive_0100_03();
  TC_req_005__tpl_s3_timeout_03();
  TC_req_005__tpl_security_lockout_01();
  TC_req_005__tpl_service_not_in_session_27_01();
  TC_req_005__tpl_session_relock_01();
  TC_req_005__tpl_write_secured_0100();
  TC_req_006__tpl_read_did_positive_0101_03();
  TC_req_006__tpl_s3_timeout_03();
  TC_req_006__tpl_security_lockout_01();
  TC_req_006__tpl_service_not_in_session_27_01();
  TC_req_006__tpl_session_relock_01();
  TC_req_006__tpl_write_secured_0101();
  TC_req_007__tpl_nrc_priority_2e_01();
  TC_req_007__tpl_read_did_positive_0130_01();
  TC_req_007__tpl_service_not_in_session_2e_01();
  TC_req_007__tpl_write_badlen_0130();
  TC_req_007__tpl_write_oor_0130();
  TC_req_007__tpl_write_secured_0130();
  TC_req_008__tpl_read_did_positive_0100_01();
  TC_req_008__tpl_write_badlen_0100();
  TC_req_008__tpl_write_oor_0100();
  TC_req_008__tpl_write_secured_0100();
  TC_req_009__tpl_negative_suppress_10_03();
  TC_req_009__tpl_read_did_positive_0150_03();
  TC_req_009__tpl_s3_timeout_02();
  TC_req_009__tpl_service_not_in_session_27_01();
  TC_req_009__tpl_session_relock_03();
  TC_req_010__tpl_read_did_positive_0101_02();
  TC_req_010__tpl_security_lockout_01();
  TC_req_010__tpl_seed_replay_01();
  TC_req_010__tpl_service_not_in_session_27_01();
  TC_req_010__tpl_write_secured_0101();
  TC_req_011__tpl_condition_not_met_routine_0202();
  TC_req_011__tpl_negative_suppress_31_02();
  TC_req_011__tpl_negative_suppress_31_03();
  TC_req_011__tpl_nrc_priority_31_01();
  TC_req_011__tpl_routine_start_results_0201();
  TC_req_012__tpl_negative_suppress_31_03();
  TC_req_012__tpl_read_did_positive_0101_02();
  TC_req_012__tpl_service_not_in_session_31_01();
  TC_req_012__tpl_write_secured_0101();
  TC_req_013__tpl_negative_suppress_11_01();
  TC_req_013__tpl_read_did_positive_0140_01();
  TC_req_013__tpl_unsupported_subfunction_11_01();
  TC_req_013__tpl_write_readonly_0140();
  TC_req_014__tpl_read_multi_0140_f190_01();
  TC_req_014__tpl_service_not_in_session_19_02();
  TC_req_014__tpl_unsupported_subfunction_19_03();
  TC_req_015__tpl_negative_suppress_3e_02();
  TC_req_015__tpl_read_did_positive_0100_01();
  TC_req_015__tpl_s3_keepalive_03();
  TC_req_015__tpl_write_secured_0100();
}
